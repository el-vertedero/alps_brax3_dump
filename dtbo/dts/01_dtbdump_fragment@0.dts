/dts-v1/;

/ {

	fragment@0 {
		target = <0xffffffff>;

		__overlay__ {

			pmic@4 {
				compatible = "mediatek,mt6377";
				reg = <0x04 0x00>;
				interrupts = <0x04>;
				#address-cells = <0x01>;
				#size-cells = <0x00>;
				interrupt-controller;
				#interrupt-cells = <0x02>;
				phandle = <0x12>;

				mtk-spmi-pmic-debug {
					compatible = "mediatek,spmi-pmic-debug";
				};

				accdet {
					compatible = "mediatek,mt6377-accdet";
					accdet-name = "mt63xx-accdet";
					accdet-mic-vol = <0x07>;
					accdet-plugout-debounce = <0x01>;
					accdet-mic-mode = <0x01>;
					eint_use_ext_res = <0x00>;
					headset-mode-setting = <0x500 0x500 0x01 0x1f0 0x800 0x800 0x20 0x44 0x04 0x01 0x05 0x03 0x03 0x05 0x0e>;
					headset-use-ap-eint = <0x00>;
					headset-eint-num = <0x00>;
					headset-eint-trig-mode = <0x01>;
					headset-key-mode = <0x00>;
					headset-three-key-threshold = <0x00 0x50 0xdc 0x190>;
					headset-three-key-threshold-CDD = <0x00 0x79 0xc0 0x258>;
					headset-four-key-threshold = <0x00 0x3a 0x79 0xc0 0x190>;
					io-channels = <0x01 0x09>;
					io-channel-names = "pmic_accdet";
					nvmem = <0x02>;
					nvmem-names = "mt63xx-accdet-efuse";
					status = "okay";
					phandle = <0x8a>;
				};

				mt6377-auxadc {
					compatible = "mediatek,pmic-auxadc\0mediatek,mt6377-auxadc";
					#io-channel-cells = <0x01>;
					isink_load-supply = <0x03>;
					phandle = <0x01>;

					batadc {
						channel = <0x00>;
						resistance-ratio = <0x07 0x02>;
						avg-num = <0x80>;
					};

					vcdt {
						channel = <0x02>;
					};

					bat-temp {
						channel = <0x03>;
						resistance-ratio = <0x05 0x02>;
					};

					chip-temp {
						channel = <0x05>;
					};

					vcore-temp {
						channel = <0x06>;
					};

					vproc-temp {
						channel = <0x07>;
					};

					vgpu-temp {
						channel = <0x08>;
					};

					accdet {
						channel = <0x09>;
					};

					hpofs-cal {
						channel = <0x0c>;
						avg-num = <0x100>;
					};

					vbif {
						channel = <0x0e>;
						resistance-ratio = <0x05 0x02>;
					};

					imp {
						channel = <0x0f>;
						resistance-ratio = <0x07 0x02>;
						avg-num = <0x80>;
					};

					imix_r {
						channel = <0x10>;
					};
				};

				mt6377_clock_buffer {
					compatible = "mediatek,clock_buffer";
					mediatek,xo-mode-num = <0x03>;
					mediatek,xo-buf-allow-control = <0x00 0x01 0x01 0x01 0x00 0x00 0x01>;
					mediatek,xo-buf-name = "XO_SOC\0XO_WCN\0XO_NFC\0XO_CEL\0RSV1\0RSV2\0XO_EXT";
					mediatek,dcxo-de-sense-support;
					mediatek,dcxo-impedance-support;
					mediatek,xo-buf-support = <0x01 0x01 0x01 0x01 0x01 0x01 0x01>;
					mediatek,xo-voter-support;
					mediatek,dcxo-spmi-rw;
					mediatek,pmrc-en-support;
					clkbuf_ctl = <0xffffffff>;
					mediatek,enable;
					phandle = <0x8b>;
				};

				mt6377-consys {
					compatible = "mediatek,mt6377-consys";
				};

				mt6377codec {
					compatible = "mediatek,mt6377-sound";
					mediatek,dmic-mode = <0x00>;
					mediatek,mic-type = <0x01 0x01 0x01>;
					io-channels = <0x01 0x0c>;
					io-channel-names = "pmic_hpofs_cal";
					nvmem = <0x02>;
					nvmem-names = "pmic-hp-efuse";
					reg-vaud28-supply = <0x04>;
					phandle = <0x8c>;
				};

				mt6377-efuse {
					compatible = "mediatek,mt6377-efuse";
					#address-cells = <0x01>;
					#size-cells = <0x01>;
					phandle = <0x02>;

					mt6377_e_data {
						reg = <0x60 0x0a>;
						phandle = <0x0b>;
					};
				};

				mt6377keys {
					compatible = "mediatek,mt6377-keys";
					mediatek,long-press-mode = <0x01>;
					power-off-time-sec = <0x00>;
					phandle = <0x8d>;

					power {
						linux,keycodes = <0x74>;
						wakeup-source;
					};

					home {
						linux,keycodes = <0x73>;
					};
				};

				mtk_gauge {
					compatible = "mediatek,mt6377-gauge";
					bootmode = <0xffffffff>;
					io-channels = <0x01 0x03 0x01 0x00 0x01 0x0e 0x01 0x0f 0x01 0x10 0x01 0x02>;
					io-channel-names = "pmic_battery_temp\0pmic_battery_voltage\0pmic_bif_voltage\0pmic_ptim_voltage\0pmic_ptim_r\0pmic_vbus_voltage";
					nvmem-cells = <0x05 0x06>;
					nvmem-cell-names = "initialization\0state-of-charge";
					charger = <0xffffffff>;
					DIFFERENCE_FULLOCV_ITH = <0xc8>;
					SHUTDOWN_1_TIME = <0x3c>;
					KEEP_100_PERCENT = <0x01>;
					CURR_MEASURE_20A = <0x00>;
					UNIT_MULTIPLE = <0x01>;
					R_FG_VALUE = <0x05>;
					EMBEDDED_SEL = <0x01>;
					PMIC_SHUTDOWN_CURRENT = <0x14>;
					FG_METER_RESISTANCE = <0x46>;
					CAR_TUNE_VALUE = <0x64>;
					PMIC_MIN_VOL = <0x82dc>;
					POWERON_SYSTEM_IBOOT = <0x1f4>;
					SHUTDOWN_GAUGE0_VOLTAGE = <0x84d0>;
					TEMPERATURE_T0 = <0x37>;
					TEMPERATURE_T1 = <0x19>;
					TEMPERATURE_T2 = <0x0a>;
					TEMPERATURE_T3 = <0x00>;
					TEMPERATURE_T4 = <0xfffffff6>;
					TEMPERATURE_T5 = <0xfffffff6>;
					g_FG_PSEUDO100_T0 = <0x64>;
					g_FG_PSEUDO100_T1 = <0x64>;
					g_FG_PSEUDO100_T2 = <0x64>;
					g_FG_PSEUDO100_T3 = <0x64>;
					g_FG_PSEUDO100_T4 = <0x64>;
					Q_MAX_SYS_VOLTAGE_BAT0 = <0xd16>;
					Q_MAX_SYS_VOLTAGE_BAT1 = <0xd16>;
					Q_MAX_SYS_VOLTAGE_BAT2 = <0xd16>;
					Q_MAX_SYS_VOLTAGE_BAT3 = <0xd16>;
					COM_FG_METER_RESISTANCE = <0x46>;
					COM_R_FG_VALUE = <0x00>;
					enable_tmp_intr_suspend = <0x00>;
					ACTIVE_TABLE = <0x06>;
					MULTI_TEMP_GAUGE0 = <0x01>;
					RBAT_PULL_UP_VOLT = <0xa8c>;
					battery0_profile_t0_num = <0x64>;
					battery0_profile_t0_col = <0x03>;
					battery0_profile_t0 = <0x00 0xad0c 0x23f 0x1f9 0xaca1 0x23f 0x3f2 0xac49 0x257 0x5eb 0xabe9 0x257 0x7e4 0xab91 0x26f 0x9dd 0xab31 0x25b 0xbd6 0xaad1 0x26c 0xdcf 0xaa67 0x25f 0xfc8 0xaa04 0x256 0x11c1 0xa99d 0x259 0x13bb 0xa931 0x256 0x15b4 0xa8c7 0x269 0x17ad 0xa856 0x263 0x19a6 0xa7e7 0x264 0x1b9f 0xa772 0x266 0x1d98 0xa6f7 0x261 0x1f91 0xa685 0x275 0x218a 0xa60c 0x265 0x2383 0xa591 0x260 0x257c 0xa51d 0x273 0x2775 0xa4a8 0x279 0x296e 0xa431 0x283 0x2b67 0xa3b6 0x270 0x2d60 0xa342 0x271 0x2f59 0xa2cd 0x271 0x3152 0xa25b 0x277 0x334b 0xa1ee 0x28a 0x3544 0xa17a 0x28a 0x373d 0xa107 0x28a 0x3936 0xa09d 0x28f 0x3b30 0xa030 0x29c 0x3d29 0x9fc0 0x292 0x3f22 0x9f5b 0x29e 0x411b 0x9ef2 0x2a4 0x4314 0x9e88 0x2a6 0x450d 0x9e26 0x2b7 0x4706 0x9dc4 0x2ba 0x48ff 0x9d5d 0x2ac 0x4af8 0x9cf8 0x2b6 0x4cf1 0x9c98 0x2d1 0x4eea 0x9c37 0x2e7 0x50e3 0x9bc6 0x2ec 0x52dc 0x9b36 0x2ca 0x54d5 0x9a95 0x28a 0x56ce 0x9a09 0x261 0x58c7 0x999e 0x265 0x5ac0 0x9944 0x265 0x5cb9 0x98f2 0x264 0x5eb2 0x98a4 0x265 0x60ab 0x985c 0x264 0x62a5 0x9818 0x265 0x649e 0x97d4 0x258 0x6697 0x9795 0x264 0x6890 0x9756 0x266 0x6a89 0x9716 0x258 0x6c82 0x96e0 0x262 0x6e7b 0x96ab 0x270 0x7074 0x9676 0x271 0x726d 0x9640 0x271 0x7466 0x960a 0x271 0x765f 0x95d8 0x26f 0x7858 0x95ab 0x27a 0x7a51 0x9580 0x280 0x7c4a 0x9554 0x279 0x7e43 0x952b 0x28c 0x803c 0x9505 0x2a0 0x8235 0x94de 0x2a3 0x842e 0x94b7 0x2a3 0x8627 0x9490 0x2a4 0x8820 0x945f 0x2a1 0x8a1a 0x941d 0x28d 0x8c13 0x93ca 0x275 0x8e0c 0x9373 0x25d 0x9005 0x9333 0x258 0x91fe 0x9300 0x26b 0x93f7 0x92c8 0x271 0x95f0 0x9296 0x271 0x97e9 0x925e 0x271 0x99e2 0x9229 0x26f 0x9bdb 0x9200 0x283 0x9dd4 0x91d3 0x278 0x9fcd 0x91a4 0x282 0xa1c6 0x9168 0x27c 0xa3bf 0x9123 0x271 0xa5b8 0x90e5 0x26e 0xa7b1 0x90a8 0x280 0xa9aa 0x905a 0x277 0xaba3 0x900a 0x24b 0xad9c 0x8fe4 0x245 0xaf95 0x8fdb 0x269 0xb18f 0x8fd2 0x290 0xb388 0x8fc6 0x2ae 0xb581 0x8fb0 0x2df 0xb77a 0x8f90 0x313 0xb973 0x8f18 0x30c 0xbb6c 0x8dd8 0x2a1 0xbd65 0x8c2a 0x2c0 0xbf5e 0x8a04 0x2d7 0xc157 0x872f 0x309 0xc350 0x8322 0x339>;
					battery0_profile_t1_num = <0x64>;
					battery0_profile_t1_col = <0x03>;
					battery0_profile_t1 = <0x00 0xad84 0x307 0x1f9 0xacf9 0x307 0x3f2 0xac9f 0x338 0x5eb 0xac47 0x322 0x7e4 0xabed 0x31f 0x9dd 0xab94 0x320 0xbd6 0xab3b 0x320 0xdcf 0xaad9 0x320 0xfc8 0xaa76 0x336 0x11c1 0xaa13 0x33a 0x13bb 0xa9a7 0x30e 0x15b4 0xa93a 0x31b 0x17ad 0xa8cd 0x336 0x19a6 0xa858 0x339 0x1b9f 0xa7e1 0x325 0x1d98 0xa76b 0x31f 0x1f91 0xa6f4 0x321 0x218a 0xa675 0x321 0x2383 0xa5fb 0x332 0x257c 0xa585 0x33a 0x2775 0xa507 0x327 0x296e 0xa48d 0x31f 0x2b67 0xa417 0x333 0x2d60 0xa39f 0x34b 0x2f59 0xa323 0x340 0x3152 0xa2a8 0x318 0x334b 0xa232 0x325 0x3544 0xa1c1 0x34d 0x373d 0xa14f 0x353 0x3936 0xa0dd 0x352 0x3b30 0xa06b 0x352 0x3d29 0x9ff9 0x352 0x3f22 0x9f8d 0x352 0x411b 0x9f21 0x354 0x4314 0x9eb9 0x36f 0x450d 0x9e51 0x385 0x4706 0x9de9 0x377 0x48ff 0x9d87 0x386 0x4af8 0x9d1f 0x3ae 0x4cf1 0x9cb7 0x3c4 0x4eea 0x9c55 0x3d1 0x50e3 0x9beb 0x3db 0x52dc 0x9b69 0x3cd 0x54d5 0x9ac9 0x38b 0x56ce 0x9a2b 0x343 0x58c7 0x99ac 0x31e 0x5ac0 0x9945 0x313 0x5cb9 0x98ec 0x2fa 0x5eb2 0x989d 0x2fa 0x60ab 0x984e 0x2fb 0x62a5 0x9803 0x2ee 0x649e 0x97c3 0x2e1 0x6697 0x9788 0x2ee 0x6890 0x9747 0x2fa 0x6a89 0x9707 0x2fb 0x6c82 0x96d0 0x306 0x6e7b 0x9699 0x307 0x7074 0x9663 0x307 0x726d 0x9631 0x307 0x7466 0x9600 0x307 0x765f 0x95ce 0x307 0x7858 0x95a1 0x308 0x7a51 0x9574 0x2fb 0x7c4a 0x9548 0x2f9 0x7e43 0x9520 0x310 0x803c 0x94f8 0x31f 0x8235 0x94d5 0x31f 0x842e 0x94b2 0x329 0x8627 0x9490 0x342 0x8820 0x946e 0x352 0x8a1a 0x9444 0x34a 0x8c13 0x940f 0x332 0x8e0c 0x93d3 0x318 0x9005 0x939b 0x308 0x91fe 0x9369 0x306 0x93f7 0x9339 0x30b 0x95f0 0x9300 0x2f5 0x97e9 0x92c3 0x2dd 0x99e2 0x929f 0x2f3 0x9bdb 0x927c 0x30a 0x9dd4 0x9247 0x2f6 0x9fcd 0x9213 0x2e5 0xa1c6 0x91e3 0x2fe 0xa3bf 0x91a0 0x2f4 0xa5b8 0x9165 0x306 0xa7b1 0x9129 0x309 0xa9aa 0x90dc 0x2fe 0xaba3 0x9083 0x2d5 0xad9c 0x905f 0x2d7 0xaf95 0x9057 0x2f6 0xb18f 0x9053 0x31c 0xb388 0x9036 0x307 0xb581 0x9022 0x327 0xb77a 0x9003 0x36e 0xb973 0x8f86 0x37e 0xbb6c 0x8e1c 0x339 0xbd65 0x8c35 0x355 0xbf5e 0x89d5 0x39d 0xc157 0x8685 0x3d1 0xc350 0x817e 0x47e>;
					battery0_profile_t2_num = <0x64>;
					battery0_profile_t2_col = <0x03>;
					battery0_profile_t2 = <0x00 0xad48 0x546 0x1f9 0xace5 0x546 0x3f2 0xac8c 0x546 0x5eb 0xac3c 0x546 0x7e4 0xabed 0x546 0x9dd 0xab95 0x52f 0xbd6 0xab3b 0x52c 0xdcf 0xaae2 0x52d 0xfc8 0xaa80 0x52d 0x11c1 0xaa1d 0x52d 0x13bb 0xa9b2 0x517 0x15b4 0xa94d 0x512 0x17ad 0xa8da 0x500 0x19a6 0xa862 0x4e6 0x1b9f 0xa7eb 0x4f5 0x1d98 0xa774 0x4fc 0x1f91 0xa6fe 0x4fa 0x218a 0xa67f 0x4e8 0x2383 0xa605 0x4e0 0x257c 0xa588 0x4d0 0x2775 0xa50e 0x4c9 0x296e 0xa498 0x4ec 0x2b67 0xa421 0x4fd 0x2d60 0xa3a3 0x4e9 0x2f59 0xa328 0x4e0 0x3152 0xa2b2 0x4e3 0x334b 0xa23b 0x4e0 0x3544 0xa1c5 0x4d5 0x373d 0xa154 0x4e6 0x3936 0xa0e2 0x500 0x3b30 0xa070 0x509 0x3d29 0xa004 0x516 0x3f22 0x9f97 0x515 0x411b 0x9f2a 0x522 0x4314 0x9ebe 0x530 0x450d 0x9e56 0x54c 0x4706 0x9dee 0x57c 0x48ff 0x9d7b 0x586 0x4af8 0x9d0a 0x584 0x4cf1 0x9c9d 0x592 0x4eea 0x9c2a 0x581 0x50e3 0x9ba8 0x54e 0x52dc 0x9b17 0x50e 0x54d5 0x9a83 0x4d2 0x56ce 0x99ff 0x494 0x58c7 0x998e 0x470 0x5ac0 0x992b 0x458 0x5cb9 0x98d3 0x43f 0x5eb2 0x9884 0x43f 0x60ab 0x983a 0x44c 0x62a5 0x97ef 0x44c 0x649e 0x97aa 0x44c 0x6697 0x976a 0x44c 0x6890 0x972e 0x44c 0x6a89 0x96f3 0x44c 0x6c82 0x96b7 0x44b 0x6e7b 0x9681 0x459 0x7074 0x964a 0x457 0x726d 0x9614 0x45a 0x7466 0x95e1 0x457 0x765f 0x95b5 0x459 0x7858 0x9588 0x462 0x7a51 0x955c 0x471 0x7c4a 0x952e 0x47b 0x7e43 0x9507 0x489 0x803c 0x94e4 0x495 0x8235 0x94bd 0x499 0x842e 0x9495 0x48d 0x8627 0x946d 0x47e 0x8820 0x944a 0x488 0x8a1a 0x9428 0x496 0x8c13 0x9400 0x498 0x8e0c 0x93d9 0x48f 0x9005 0x93ae 0x476 0x91fe 0x937e 0x468 0x93f7 0x9348 0x45c 0x95f0 0x9310 0x44d 0x97e9 0x92e1 0x44a 0x99e2 0x92b9 0x454 0x9bdb 0x9292 0x464 0x9dd4 0x9268 0x465 0x9fcd 0x9235 0x465 0xa1c6 0x91f6 0x464 0xa3bf 0x91b6 0x468 0xa5b8 0x9184 0x489 0xa7b1 0x9143 0x4ab 0xa9aa 0x90e8 0x491 0xaba3 0x9099 0x482 0xad9c 0x907c 0x49a 0xaf95 0x9069 0x4b2 0xb18f 0x905e 0x4ce 0xb388 0x904b 0x4ff 0xb581 0x9035 0x531 0xb77a 0x9000 0x562 0xb973 0x8f5c 0x575 0xbb6c 0x8dd4 0x562 0xbd65 0x8bc3 0x5ad 0xbf5e 0x891f 0x5f7 0xc157 0x856a 0x6a9 0xc350 0x7f58 0x866>;
					battery0_profile_t3_num = <0x64>;
					battery0_profile_t3_col = <0x03>;
					battery0_profile_t3 = <0x00 0xad66 0x916 0x1f9 0xacef 0x915 0x3f2 0xac8c 0x915 0x5eb 0xac32 0x915 0x7e4 0xabda 0x8fd 0x9dd 0xab81 0x8e4 0xbd6 0xab28 0x8cc 0xdcf 0xaace 0x8c9 0xfc8 0xaa6c 0x8b4 0x11c1 0xaa09 0x89a 0x13bb 0xa9a6 0x897 0x15b4 0xa93b 0x883 0x17ad 0xa8cd 0x869 0x19a6 0xa858 0x850 0x1b9f 0xa7e1 0x838 0x1d98 0xa76a 0x81f 0x1f91 0xa6f4 0x819 0x218a 0xa67c 0x808 0x2383 0xa5fe 0x7ee 0x257c 0xa584 0x7e8 0x2775 0xa50e 0x7e8 0x296e 0xa490 0x7d7 0x2b67 0xa416 0x7ce 0x2d60 0xa3a0 0x7d1 0x2f59 0xa329 0x7cf 0x3152 0xa2b3 0x7c0 0x334b 0xa23b 0x7b5 0x3544 0xa1c5 0x7b9 0x373d 0xa154 0x7c6 0x3936 0xa0e2 0x7d3 0x3b30 0xa070 0x7dd 0x3d29 0x9ffe 0x7dd 0x3f22 0x9f8d 0x7de 0x411b 0x9f27 0x7fa 0x4314 0x9ebe 0x812 0x450d 0x9e4b 0x82a 0x4706 0x9dd3 0x835 0x48ff 0x9d5d 0x834 0x4af8 0x9ce6 0x833 0x4cf1 0x9c6a 0x817 0x4eea 0x9be3 0x7d5 0x50e3 0x9b58 0x78c 0x52dc 0x9ad8 0x74d 0x54d5 0x9a5d 0x712 0x56ce 0x99e6 0x6ec 0x58c7 0x997a 0x6d6 0x5ac0 0x9917 0x6bc 0x5cb9 0x98bf 0x6b1 0x5eb2 0x986b 0x6a4 0x60ab 0x9821 0x6a4 0x62a5 0x97db 0x6a4 0x649e 0x9796 0x6a4 0x6697 0x9756 0x6b1 0x6890 0x9715 0x6b0 0x6a89 0x96d4 0x6b0 0x6c82 0x969e 0x6c8 0x6e7b 0x966d 0x6d7 0x7074 0x9636 0x6c8 0x726d 0x9600 0x6d5 0x7466 0x95cd 0x6ed 0x765f 0x959c 0x6ef 0x7858 0x956a 0x6ef 0x7a51 0x953d 0x6ef 0x7c4a 0x9515 0x6f0 0x7e43 0x94ee 0x6ec 0x803c 0x94c6 0x706 0x8235 0x949e 0x713 0x842e 0x947b 0x713 0x8627 0x9458 0x728 0x8820 0x9435 0x745 0x8a1a 0x9417 0x749 0x8c13 0x93f9 0x73a 0x8e0c 0x93dc 0x743 0x9005 0x93ba 0x752 0x91fe 0x9397 0x753 0x93f7 0x9377 0x754 0x95f0 0x934b 0x750 0x97e9 0x931d 0x763 0x99e2 0x92f5 0x782 0x9bdb 0x92cf 0x78c 0x9dd4 0x92a2 0x7a0 0x9fcd 0x9268 0x7c9 0xa1c6 0x9229 0x804 0xa3bf 0x91e6 0x822 0xa5b8 0x91ac 0x85a 0xa7b1 0x916b 0x89f 0xa9aa 0x9110 0x8d0 0xaba3 0x90be 0x906 0xad9c 0x908f 0x94e 0xaf95 0x9071 0x99f 0xb18f 0x9054 0xa1a 0xb388 0x9040 0xa98 0xb581 0x9020 0xb30 0xb77a 0x8fed 0xbfb 0xb973 0x8f75 0xcce 0xbb6c 0x8e3a 0xd55 0xbd65 0x8c43 0xe9b 0xbf5e 0x89bd 0x1011 0xc157 0x8650 0x1281 0xc350 0x8106 0x165d>;
					battery0_profile_t4_num = <0x64>;
					battery0_profile_t4_col = <0x03>;
					battery0_profile_t4 = <0x00 0xad52 0x133c 0x1f9 0xacaa 0x133d 0x3f2 0xac1f 0x1355 0x5eb 0xab9e 0x12f6 0x7e4 0xab27 0x12a9 0x9dd 0xaaba 0x1260 0xbd6 0xaa44 0x11ff 0xdcf 0xa9d6 0x11b2 0xfc8 0xa960 0x1152 0x11c1 0xa8f1 0x1104 0x13bb 0xa885 0x10bb 0x15b4 0xa818 0x1085 0x17ad 0xa7ab 0x1040 0x19a6 0xa736 0xff5 0x1b9f 0xa6c7 0xfbf 0x1d98 0xa65b 0xf8f 0x1f91 0xa5e6 0xf4a 0x218a 0xa576 0xf23 0x2383 0xa503 0xeea 0x257c 0xa48b 0xeae 0x2775 0xa41c 0xe7f 0x296e 0xa3a9 0xe4d 0x2b67 0xa338 0xe2d 0x2d60 0xa2cc 0xe15 0x2f59 0xa258 0xdec 0x3152 0xa1e6 0xdc8 0x334b 0xa174 0xda3 0x3544 0xa102 0xd7f 0x373d 0xa091 0xd68 0x3936 0xa020 0xd50 0x3b30 0x9fb9 0xd46 0x3d29 0x9f51 0xd37 0x3f22 0x9edd 0xd0f 0x411b 0x9e5f 0xcea 0x4314 0x9dd9 0xcc6 0x450d 0x9d4e 0xca0 0x4706 0x9cc3 0xc89 0x48ff 0x9c39 0xc71 0x4af8 0x9bb4 0xc66 0x4cf1 0x9b34 0xc68 0x4eea 0x9abd 0xc75 0x50e3 0x9a57 0xc8f 0x52dc 0x99f4 0xca6 0x54d5 0x9991 0xca6 0x56ce 0x9933 0xca5 0x58c7 0x98d6 0xcb3 0x5ac0 0x987d 0xcbf 0x5cb9 0x982e 0xcd8 0x5eb2 0x97df 0xce4 0x60ab 0x9795 0xcf0 0x62a5 0x974f 0xd09 0x649e 0x970a 0xd22 0x6697 0x96ca 0xd3b 0x6890 0x968e 0xd54 0x6a89 0x9653 0xd6c 0x6c82 0x9617 0xd85 0x6e7b 0x95e0 0xd9d 0x7074 0x95ae 0xdc3 0x726d 0x957d 0xde8 0x7466 0x954b 0xe01 0x765f 0x951e 0xe24 0x7858 0x94f6 0xe56 0x7a51 0x94cf 0xe7c 0x7c4a 0x94a7 0xea0 0x7e43 0x9484 0xed0 0x803c 0x9466 0xf04 0x8235 0x9448 0xf29 0x842e 0x942e 0xf4d 0x8627 0x941a 0xf81 0x8820 0x9402 0xf9b 0x8a1a 0x93e8 0xfb1 0x8c13 0x93d5 0xfe1 0x8e0c 0x93bd 0x100b 0x9005 0x93a0 0x1020 0x91fe 0x9383 0x104e 0x93f7 0x9362 0x1086 0x95f0 0x933a 0x109e 0x97e9 0x9313 0x10c5 0x99e2 0x92e9 0x1111 0x9bdb 0x92b5 0x114a 0x9dd4 0x927b 0x1172 0x9fcd 0x923d 0x11ba 0xa1c6 0x91f8 0x120a 0xa3bf 0x91b3 0x126b 0xa5b8 0x916e 0x12d5 0xa7b1 0x9127 0x1349 0xa9aa 0x90d6 0x13b4 0xaba3 0x908a 0x1453 0xad9c 0x9050 0x1513 0xaf95 0x9020 0x15c4 0xb18f 0x8ff8 0x1689 0xb388 0x8fd0 0x1752 0xb581 0x8f9d 0x182e 0xb77a 0x8f55 0x18f2 0xb973 0x8ec0 0x195f 0xbb6c 0x8d7c 0x18f7 0xbd65 0x8b9b 0x1868 0xbf5e 0x890b 0x1854 0xc157 0x8593 0x1817 0xc350 0x802a 0x1531>;
					battery0_profile_t5_num = <0x64>;
					battery0_profile_t5_col = <0x03>;
					battery0_profile_t5 = <0x00 0xad52 0x133c 0x1f9 0xacaa 0x133d 0x3f2 0xac1f 0x1355 0x5eb 0xab9e 0x12f6 0x7e4 0xab27 0x12a9 0x9dd 0xaaba 0x1260 0xbd6 0xaa44 0x11ff 0xdcf 0xa9d6 0x11b2 0xfc8 0xa960 0x1152 0x11c1 0xa8f1 0x1104 0x13bb 0xa885 0x10bb 0x15b4 0xa818 0x1085 0x17ad 0xa7ab 0x1040 0x19a6 0xa736 0xff5 0x1b9f 0xa6c7 0xfbf 0x1d98 0xa65b 0xf8f 0x1f91 0xa5e6 0xf4a 0x218a 0xa576 0xf23 0x2383 0xa503 0xeea 0x257c 0xa48b 0xeae 0x2775 0xa41c 0xe7f 0x296e 0xa3a9 0xe4d 0x2b67 0xa338 0xe2d 0x2d60 0xa2cc 0xe15 0x2f59 0xa258 0xdec 0x3152 0xa1e6 0xdc8 0x334b 0xa174 0xda3 0x3544 0xa102 0xd7f 0x373d 0xa091 0xd68 0x3936 0xa020 0xd50 0x3b30 0x9fb9 0xd46 0x3d29 0x9f51 0xd37 0x3f22 0x9edd 0xd0f 0x411b 0x9e5f 0xcea 0x4314 0x9dd9 0xcc6 0x450d 0x9d4e 0xca0 0x4706 0x9cc3 0xc89 0x48ff 0x9c39 0xc71 0x4af8 0x9bb4 0xc66 0x4cf1 0x9b34 0xc68 0x4eea 0x9abd 0xc75 0x50e3 0x9a57 0xc8f 0x52dc 0x99f4 0xca6 0x54d5 0x9991 0xca6 0x56ce 0x9933 0xca5 0x58c7 0x98d6 0xcb3 0x5ac0 0x987d 0xcbf 0x5cb9 0x982e 0xcd8 0x5eb2 0x97df 0xce4 0x60ab 0x9795 0xcf0 0x62a5 0x974f 0xd09 0x649e 0x970a 0xd22 0x6697 0x96ca 0xd3b 0x6890 0x968e 0xd54 0x6a89 0x9653 0xd6c 0x6c82 0x9617 0xd85 0x6e7b 0x95e0 0xd9d 0x7074 0x95ae 0xdc3 0x726d 0x957d 0xde8 0x7466 0x954b 0xe01 0x765f 0x951e 0xe24 0x7858 0x94f6 0xe56 0x7a51 0x94cf 0xe7c 0x7c4a 0x94a7 0xea0 0x7e43 0x9484 0xed0 0x803c 0x9466 0xf04 0x8235 0x9448 0xf29 0x842e 0x942e 0xf4d 0x8627 0x941a 0xf81 0x8820 0x9402 0xf9b 0x8a1a 0x93e8 0xfb1 0x8c13 0x93d5 0xfe1 0x8e0c 0x93bd 0x100b 0x9005 0x93a0 0x1020 0x91fe 0x9383 0x104e 0x93f7 0x9362 0x1086 0x95f0 0x933a 0x109e 0x97e9 0x9313 0x10c5 0x99e2 0x92e9 0x1111 0x9bdb 0x92b5 0x114a 0x9dd4 0x927b 0x1172 0x9fcd 0x923d 0x11ba 0xa1c6 0x91f8 0x120a 0xa3bf 0x91b3 0x126b 0xa5b8 0x916e 0x12d5 0xa7b1 0x9127 0x1349 0xa9aa 0x90d6 0x13b4 0xaba3 0x908a 0x1453 0xad9c 0x9050 0x1513 0xaf95 0x9020 0x15c4 0xb18f 0x8ff8 0x1689 0xb388 0x8fd0 0x1752 0xb581 0x8f9d 0x182e 0xb77a 0x8f55 0x18f2 0xb973 0x8ec0 0x195f 0xbb6c 0x8d7c 0x18f7 0xbd65 0x8b9b 0x1868 0xbf5e 0x890b 0x1854 0xc157 0x8593 0x1817 0xc350 0x802a 0x1531>;
					g_PMIC_MIN_VOL_row = <0x04>;
					g_PMIC_MIN_VOL_col = <0x0a>;
					g_PMIC_MIN_VOL = <0x82dc 0x82dc 0x82dc 0x82dc 0x80e8 0x80e8 0x80e8 0x80e8 0x80e8 0x80e8 0x80e8 0x80e8 0x7dc8 0x7dc8 0x7dc8 0x7dc8 0x7918 0x7918 0x7918 0x7918 0x7b0c 0x7b0c 0x7b0c 0x7b0c 0x7918 0x7918 0x7918 0x7918 0x7918 0x7918 0x7918 0x7918 0x7918 0x7918 0x7918 0x7918 0x7918 0x7918 0x7918 0x79e0>;
					g_PON_SYS_IBOOT_row = <0x04>;
					g_PON_SYS_IBOOT_col = <0x0a>;
					g_PON_SYS_IBOOT = <0x1388 0x1388 0x1388 0x1388 0x1388 0x1388 0x1388 0x1388 0x1388 0x1388 0x1388 0x1388 0x1388 0x1388 0x1388 0x1388 0x1388 0x1388 0x1388 0x1388 0x1388 0x1388 0x1388 0x1388 0x1388 0x1388 0x1388 0x1388 0x1388 0x1388 0x1388 0x1388 0x1388 0x1388 0x1388 0x1388 0x1388 0x1388 0x1388 0x1388>;
					g_QMAX_SYS_VOL_row = <0x04>;
					g_QMAX_SYS_VOL_col = <0x0a>;
					g_QMAX_SYS_VOL = <0x8886 0x8886 0x8886 0x8886 0x8886 0x8886 0x8886 0x8886 0x85ca 0x85ca 0x85ca 0x85ca 0x85ca 0x85ca 0x85ca 0x85ca 0x85ca 0x85ca 0x85ca 0x85ca 0x7ef4 0x7ef4 0x7ef4 0x7ef4 0x8020 0x8020 0x8020 0x8020 0x8020 0x8020 0x8020 0x8020 0x8020 0x8020 0x8020 0x8020 0x8020 0x8020 0x8020 0x8020>;
					g_FG_PSEUDO100_row = <0x04>;
					g_FG_PSEUDO100_col = <0x0a>;
					g_FG_PSEUDO100 = <0x64 0x64 0x64 0x64 0x64 0x64 0x64 0x64 0x64 0x64 0x64 0x64 0x64 0x64 0x64 0x64 0x64 0x64 0x64 0x64 0x64 0x64 0x64 0x64 0x64 0x64 0x64 0x64 0x64 0x64 0x64 0x64 0x64 0x64 0x64 0x64 0x64 0x64 0x64 0x64>;
					g_FG_charge_PSEUDO100_row = <0x04>;
					g_FG_charge_PSEUDO100_col = <0x0a>;
					g_FG_charge_PSEUDO100 = <0x64 0x64 0x64 0x64 0x64 0x64 0x64 0x64 0x64 0x64 0x64 0x64 0x64 0x64 0x64 0x64 0x64 0x64 0x64 0x64 0x64 0x64 0x64 0x64 0x64 0x64 0x64 0x64 0x64 0x64 0x64 0x64 0x64 0x64 0x64 0x64 0x64 0x64 0x64 0x64>;
					phandle = <0x1e>;
				};

				regulators {

					vbuck1 {
						regulator-compatible = "VBUCK1";
						regulator-name = "mt6377_vbuck1";
						regulator-min-microvolt = <0x493e0>;
						regulator-max-microvolt = <0x123716>;
						regulator-enable-ramp-delay = <0xb4>;
						regulator-allowed-modes = <0x00 0x01 0x02>;
						regulator-always-on;
						phandle = <0x17>;
					};

					vbuck2 {
						regulator-compatible = "VBUCK2";
						regulator-name = "mt6377_vbuck2";
						regulator-min-microvolt = <0x493e0>;
						regulator-max-microvolt = <0x123716>;
						regulator-enable-ramp-delay = <0xb4>;
						regulator-allowed-modes = <0x00 0x01 0x02>;
						phandle = <0x8e>;
					};

					vbuck3 {
						regulator-compatible = "VBUCK3";
						regulator-name = "mt6377_vbuck3";
						regulator-min-microvolt = <0x493e0>;
						regulator-max-microvolt = <0x123716>;
						regulator-enable-ramp-delay = <0xb4>;
						regulator-allowed-modes = <0x00 0x01 0x02>;
						regulator-always-on;
						phandle = <0x0c>;
					};

					vbuck4 {
						regulator-compatible = "VBUCK4";
						regulator-name = "mt6377_vbuck4";
						regulator-min-microvolt = <0x493e0>;
						regulator-max-microvolt = <0x123716>;
						regulator-enable-ramp-delay = <0xb4>;
						regulator-allowed-modes = <0x00 0x01 0x02>;
						regulator-always-on;
						phandle = <0x16>;
					};

					vbuck5 {
						regulator-compatible = "VBUCK5";
						regulator-name = "mt6377_vbuck5";
						regulator-min-microvolt = <0x493e0>;
						regulator-max-microvolt = <0x123716>;
						regulator-enable-ramp-delay = <0xb4>;
						regulator-allowed-modes = <0x00 0x01 0x02>;
						regulator-always-on;
						phandle = <0x15>;
					};

					vbuck6 {
						regulator-compatible = "VBUCK6";
						regulator-name = "mt6377_vbuck6";
						regulator-min-microvolt = <0x493e0>;
						regulator-max-microvolt = <0x123716>;
						regulator-enable-ramp-delay = <0xb4>;
						regulator-allowed-modes = <0x00 0x01 0x02>;
						regulator-always-on;
						phandle = <0x8f>;
					};

					vs1 {
						regulator-compatible = "VS1";
						regulator-name = "mt6377_vs1";
						regulator-min-microvolt = <0x493e0>;
						regulator-max-microvolt = <0x2191c0>;
						regulator-enable-ramp-delay = <0xb4>;
						regulator-allowed-modes = <0x00 0x01 0x02>;
						regulator-always-on;
						regulator-allow-set-load;
						phandle = <0x90>;
					};

					vs2 {
						regulator-compatible = "VS2";
						regulator-name = "mt6377_vs2";
						regulator-min-microvolt = <0x493e0>;
						regulator-max-microvolt = <0x186a00>;
						regulator-enable-ramp-delay = <0xb4>;
						regulator-allowed-modes = <0x00 0x01 0x02>;
						regulator-always-on;
						regulator-allow-set-load;
						phandle = <0x91>;
					};

					vsram-md {
						regulator-compatible = "VSRAM_MD";
						regulator-name = "mt6377_vsram_md";
						regulator-min-microvolt = <0x7a120>;
						regulator-max-microvolt = <0x13bdb6>;
						regulator-enable-ramp-delay = <0xb4>;
						regulator-allowed-modes = <0x00 0x02>;
						regulator-always-on;
						phandle = <0x92>;
					};

					vsram-proc1 {
						regulator-compatible = "VSRAM_PROC1";
						regulator-name = "mt6377_vsram_proc1";
						regulator-min-microvolt = <0x7a120>;
						regulator-max-microvolt = <0x13bdb6>;
						regulator-enable-ramp-delay = <0xb4>;
						regulator-allowed-modes = <0x00 0x02>;
						regulator-always-on;
						phandle = <0x93>;
					};

					vsram-proc2 {
						regulator-compatible = "VSRAM_PROC2";
						regulator-name = "mt6377_vsram_proc2";
						regulator-min-microvolt = <0x7a120>;
						regulator-max-microvolt = <0x13bdb6>;
						regulator-enable-ramp-delay = <0xb4>;
						regulator-allowed-modes = <0x00 0x02>;
						regulator-always-on;
						phandle = <0x94>;
					};

					vsram-others {
						regulator-compatible = "VSRAM_OTHERS";
						regulator-name = "mt6377_vsram_others";
						regulator-min-microvolt = <0x7a120>;
						regulator-max-microvolt = <0x13bdb6>;
						regulator-enable-ramp-delay = <0xb4>;
						regulator-allowed-modes = <0x00 0x02>;
						regulator-always-on;
						phandle = <0x0e>;
					};

					va12 {
						regulator-compatible = "VA12";
						regulator-name = "mt6377_va12";
						regulator-min-microvolt = <0x10c8e0>;
						regulator-max-microvolt = <0x13d620>;
						regulator-enable-ramp-delay = <0x2a8>;
						regulator-allowed-modes = <0x00 0x02>;
						regulator-always-on;
						regulator-allow-set-load;
						phandle = <0x95>;
					};

					vaud18 {
						regulator-compatible = "VAUD18";
						regulator-name = "mt6377_vaud18";
						regulator-min-microvolt = <0x19f0a0>;
						regulator-max-microvolt = <0x1cfde0>;
						regulator-enable-ramp-delay = <0x2a8>;
						regulator-allowed-modes = <0x00 0x02>;
						regulator-allow-set-load;
						phandle = <0x66>;
					};

					vaud28 {
						regulator-compatible = "VAUD28";
						regulator-name = "mt6377_vaud28";
						regulator-min-microvolt = <0x2932e0>;
						regulator-max-microvolt = <0x2c4020>;
						regulator-enable-ramp-delay = <0xf0>;
						regulator-allowed-modes = <0x00 0x02>;
						regulator-always-on;
						regulator-allow-set-load;
						phandle = <0x04>;
					};

					vaux18 {
						regulator-compatible = "VAUX18";
						regulator-name = "mt6377_vaux18";
						regulator-min-microvolt = <0x1b7740>;
						regulator-max-microvolt = <0x1cfde0>;
						regulator-enable-ramp-delay = <0xf0>;
						regulator-allowed-modes = <0x00 0x02>;
						regulator-always-on;
						regulator-allow-set-load;
						phandle = <0x96>;
					};

					vbif28 {
						regulator-compatible = "VBIF28";
						regulator-name = "mt6377_vbif28";
						regulator-min-microvolt = <0x2932e0>;
						regulator-max-microvolt = <0x2c4020>;
						regulator-enable-ramp-delay = <0x2a8>;
						regulator-allowed-modes = <0x00 0x02>;
						regulator-allow-set-load;
						regulator-always-on;
						phandle = <0x97>;
					};

					vcn33-1 {
						regulator-compatible = "VCN33_1";
						regulator-name = "mt6377_vcn33_1";
						regulator-min-microvolt = <0x2ab980>;
						regulator-max-microvolt = <0x3567e0>;
						regulator-enable-ramp-delay = <0x2a8>;
						regulator-allowed-modes = <0x00 0x02>;
						regulator-allow-set-load;
						phandle = <0x98>;
					};

					vcn33-2 {
						regulator-compatible = "VCN33_2";
						regulator-name = "mt6377_vcn33_2";
						regulator-min-microvolt = <0x2ab980>;
						regulator-max-microvolt = <0x3567e0>;
						regulator-enable-ramp-delay = <0x2a8>;
						regulator-allowed-modes = <0x00 0x02>;
						regulator-allow-set-load;
						phandle = <0x99>;
					};

					vcn18 {
						regulator-compatible = "VCN18";
						regulator-name = "mt6377_vcn18";
						regulator-min-microvolt = <0x186a00>;
						regulator-max-microvolt = <0x1b7740>;
						regulator-enable-ramp-delay = <0x2a8>;
						regulator-allowed-modes = <0x00 0x02>;
						regulator-allow-set-load;
						phandle = <0x9a>;
					};

					vxo22 {
						regulator-compatible = "VXO22";
						regulator-name = "mt6377_vxo22";
						regulator-min-microvolt = <0x1b7740>;
						regulator-max-microvolt = <0x2191c0>;
						regulator-enable-ramp-delay = <0xc8>;
						regulator-allowed-modes = <0x00 0x02>;
						regulator-always-on;
						regulator-allow-set-load;
						phandle = <0x9b>;
					};

					vm18 {
						regulator-compatible = "VM18";
						regulator-name = "mt6377_vm18";
						regulator-min-microvolt = <0x19f0a0>;
						regulator-max-microvolt = <0x1cfde0>;
						regulator-enable-ramp-delay = <0x2a8>;
						regulator-allowed-modes = <0x00 0x02>;
						regulator-always-on;
						regulator-allow-set-load;
						phandle = <0x9c>;
					};

					vefuse {
						regulator-compatible = "VEFUSE";
						regulator-name = "mt6377_vefuse";
						regulator-min-microvolt = <0x19f0a0>;
						regulator-max-microvolt = <0x1cfde0>;
						regulator-enable-ramp-delay = <0x2a8>;
						regulator-allowed-modes = <0x00 0x02>;
						regulator-allow-set-load;
						phandle = <0x9d>;
					};

					vemc {
						regulator-compatible = "VEMC";
						regulator-name = "mt6377_vemc";
						regulator-min-microvolt = <0x124f80>;
						regulator-max-microvolt = <0x3567e0>;
						regulator-enable-ramp-delay = <0x2a8>;
						regulator-allowed-modes = <0x00 0x02>;
						regulator-allow-set-load;
						phandle = <0x11>;
					};

					vufs {
						regulator-compatible = "VUFS";
						regulator-name = "mt6377_vufs";
						regulator-min-microvolt = <0x19f0a0>;
						regulator-max-microvolt = <0x1cfde0>;
						regulator-enable-ramp-delay = <0x2a8>;
						regulator-allowed-modes = <0x00 0x02>;
						regulator-allow-set-load;
						regulator-always-on;
						phandle = <0x1b>;
					};

					vio18 {
						regulator-compatible = "VIO18";
						regulator-name = "mt6377_vio18";
						regulator-min-microvolt = <0x19f0a0>;
						regulator-max-microvolt = <0x1cfde0>;
						regulator-enable-ramp-delay = <0x2a8>;
						regulator-allowed-modes = <0x00 0x02>;
						regulator-always-on;
						regulator-allow-set-load;
						phandle = <0x9e>;
					};

					vrf18 {
						regulator-compatible = "VRF18";
						regulator-name = "mt6377_vrf18";
						regulator-min-microvolt = <0x19f0a0>;
						regulator-max-microvolt = <0x1cfde0>;
						regulator-enable-ramp-delay = <0xc8>;
						regulator-allowed-modes = <0x00 0x02>;
						regulator-allow-set-load;
						phandle = <0x9f>;
					};

					vrf12 {
						regulator-compatible = "VRF12";
						regulator-name = "mt6377_vrf12";
						regulator-min-microvolt = <0x10c8e0>;
						regulator-max-microvolt = <0x13d620>;
						regulator-enable-ramp-delay = <0xb4>;
						regulator-allowed-modes = <0x00 0x02>;
						regulator-allow-set-load;
						phandle = <0xa0>;
					};

					vrf09 {
						regulator-compatible = "VRF09";
						regulator-name = "mt6377_vrf09";
						regulator-min-microvolt = <0xdbba0>;
						regulator-max-microvolt = <0xf4240>;
						regulator-enable-ramp-delay = <0xb4>;
						regulator-allowed-modes = <0x00 0x02>;
						regulator-allow-set-load;
						phandle = <0xa1>;
					};

					vrfva12 {
						regulator-compatible = "VRFVA12";
						regulator-name = "mt6377_vrfva12";
						regulator-min-microvolt = <0x10c8e0>;
						regulator-max-microvolt = <0x13d620>;
						regulator-enable-ramp-delay = <0xc8>;
						regulator-allowed-modes = <0x00 0x02>;
						regulator-allow-set-load;
						regulator-always-on;
						phandle = <0xa2>;
					};

					vrfio18 {
						regulator-compatible = "VRFIO18";
						regulator-name = "mt6377_vrfio18";
						regulator-min-microvolt = <0x19f0a0>;
						regulator-max-microvolt = <0x1cfde0>;
						regulator-enable-ramp-delay = <0x1f4>;
						regulator-allowed-modes = <0x00 0x02>;
						regulator-allow-set-load;
						regulator-always-on;
						phandle = <0xa3>;
					};

					vmc {
						regulator-compatible = "VMC";
						regulator-name = "mt6377_vmc";
						regulator-min-microvolt = <0x19f0a0>;
						regulator-max-microvolt = <0x2dc6c0>;
						regulator-enable-ramp-delay = <0x2a8>;
						regulator-allowed-modes = <0x00 0x02>;
						regulator-allow-set-load;
						phandle = <0x1d>;
					};

					vusb {
						regulator-compatible = "VUSB";
						regulator-name = "mt6377_vusb";
						regulator-min-microvolt = <0x2dc6c0>;
						regulator-max-microvolt = <0x2dc6c0>;
						regulator-enable-ramp-delay = <0x2a8>;
						regulator-allowed-modes = <0x00 0x02>;
						regulator-always-on;
						regulator-allow-set-load;
						phandle = <0x1a>;
					};

					vibr {
						regulator-compatible = "VIBR";
						regulator-name = "mt6377_vibr";
						regulator-min-microvolt = <0x124f80>;
						regulator-max-microvolt = <0x325aa0>;
						regulator-enable-ramp-delay = <0xc8>;
						regulator-allowed-modes = <0x00 0x02>;
						regulator-allow-set-load;
						phandle = <0x18>;
					};

					vio28 {
						regulator-compatible = "VIO28";
						regulator-name = "mt6377_vio28";
						regulator-min-microvolt = <0x124f80>;
						regulator-max-microvolt = <0x325aa0>;
						regulator-enable-ramp-delay = <0xc8>;
						regulator-allowed-modes = <0x00 0x02>;
						regulator-always-on;
						regulator-allow-set-load;
						phandle = <0xa4>;
					};

					vfp {
						regulator-compatible = "VFP";
						regulator-name = "mt6377_vfp";
						regulator-min-microvolt = <0x325aa0>;
						regulator-max-microvolt = <0x325aa0>;
						regulator-enable-ramp-delay = <0xc8>;
						regulator-allowed-modes = <0x00 0x02>;
						regulator-allow-set-load;
						regulator-always-on;
						phandle = <0x86>;
					};

					vtp {
						regulator-compatible = "VTP";
						regulator-name = "mt6377_vtp";
						regulator-min-microvolt = <0x124f80>;
						regulator-max-microvolt = <0x325aa0>;
						regulator-enable-ramp-delay = <0xc8>;
						regulator-allowed-modes = <0x00 0x02>;
						regulator-allow-set-load;
						phandle = <0x19>;
					};

					isink-load {
						regulator-compatible = "isink_load";
						regulator-name = "mt6377_isink_load";
						phandle = <0x03>;
					};

					vbuck3-sshub {
						regulator-compatible = "VBUCK3_SSHUB";
						regulator-name = "mt6377_vbuck3_sshub";
						regulator-min-microvolt = <0x493e0>;
						regulator-max-microvolt = <0x123716>;
						phandle = <0x0f>;
					};

					vsram-others-sshub {
						regulator-compatible = "VSRAM_OTHERS_SSHUB";
						regulator-name = "mt6377_vsram_others_sshub";
						regulator-min-microvolt = <0x7a120>;
						regulator-max-microvolt = <0x13bdb6>;
						phandle = <0x10>;
					};

					vmch-eint-low {
						regulator-compatible = "VMCH_EINT_LOW";
						regulator-name = "mt6377_vmch_eint_low";
						regulator-min-microvolt = <0x19f0a0>;
						regulator-max-microvolt = <0x325aa0>;
						regulator-enable-ramp-delay = <0x2a8>;
						regulator-allowed-modes = <0x00 0x02>;
						phandle = <0x1c>;
					};
				};

				lbat-service {
					compatible = "mediatek,mt6377-lbat-service";
					phandle = <0xa5>;
				};

				mt6377_rtc {
					status = "okay";
					compatible = "mediatek,mt6377-rtc";
					base = <0x580>;
					#address-cells = <0x01>;
					#size-cells = <0x01>;
					phandle = <0xa6>;

					fg_init {
						reg = <0x00 0x01>;
						phandle = <0x05>;
					};

					fg_soc {
						reg = <0x01 0x01>;
						phandle = <0x06>;
					};

					ext_32k {
						reg = <0x02 0x01>;
						bits = <0x06 0x01>;
						phandle = <0xa7>;
					};
				};
			};
		};
	};

	fragment@1 {
		target = <0xffffffff>;

		__overlay__ {
			host-index = <0x00>;
			status = "okay";
			pinctrl-names = "default\0state_uhs";
			pinctrl-0 = <0x07>;
			pinctrl-1 = <0x08>;
			bus-width = <0x08>;
			max-frequency = <0xbebc200>;
			ocr-voltage = <0x30000>;
			cap-mmc-highspeed;
			mmc-ddr-1_8v;
			mmc-hs200-1_8v;
			mmc-hs400-1_8v;
			hs400-ds-delay = <0x12818>;
			read-dat-cnt-hs400 = <0x03>;
			no-sdio;
			no-sd;
			non-removable;
			supports-cqe;
			dvfsrc-vcore-supply = <0xffffffff>;
			req-vcore = <0x9eb10>;
			cap-mmc-hw-reset;
		};
	};

	fragment@2 {
		target = <0xffffffff>;

		__overlay__ {
			host-index = <0x01>;
			status = "okay";
			pinctrl-names = "default\0state_uhs";
			pinctrl-0 = <0x09>;
			pinctrl-1 = <0x0a>;
			bus-width = <0x04>;
			max-frequency = <0xbebc200>;
			ocr-voltage = <0x30000>;
			cap-sd-highspeed;
			sd-uhs-sdr12;
			sd-uhs-sdr25;
			sd-uhs-sdr50;
			sd-uhs-sdr104;
			sd-uhs-ddr50;
			cd-debounce-delay-ms = <0x00>;
			cd-gpios = <0xffffffff 0x0e 0x00>;
			no-mmc;
			no-sdio;
			dvfsrc-vcore-supply = <0xffffffff>;
			req-vcore = <0x9eb10>;
			mediatek,mmc-qos;
			interconnects = <0xffffffff 0x15 0xffffffff 0x00>;
			interconnect-names = "msdc-perf-bw";
			required-opps = <0xffffffff>;
		};
	};

	fragment@3 {
		target = <0xffffffff>;

		__overlay__ {

			mmc0default {
				phandle = <0x07>;

				pins_cmd_dat {
					pinmux = <0xb901 0xba01 0xbb01 0xbc01 0xbd01 0xbe01 0xbf01 0xc001 0xb701>;
					input-enable;
					drive-strength = <0x04>;
					bias-pull-up = <0x65>;
				};

				pins_clk {
					pinmux = <0xb601>;
					drive-strength = <0x04>;
					bias-pull-down = <0x66>;
				};

				pins_rst {
					pinmux = <0xb801>;
					drive-strength = <0x04>;
					bias-pull-up = <0x64>;
				};
			};

			mmc0@0 {
				phandle = <0x08>;

				pins_cmd_dat {
					pinmux = <0xb901 0xba01 0xbb01 0xbc01 0xbd01 0xbe01 0xbf01 0xc001 0xb701>;
					input-enable;
					drive-strength = <0x04>;
					bias-pull-up = <0x65>;
				};

				pins_clk {
					pinmux = <0xb601>;
					drive-strength = <0x04>;
					bias-pull-down = <0x66>;
				};

				pins_ds {
					pinmux = <0xb501>;
					drive-strength = <0x04>;
					bias-pull-down = <0x66>;
				};

				pins_rst {
					pinmux = <0xb801>;
					drive-strength = <0x04>;
					bias-pull-up = <0x64>;
				};
			};

			mmc1default {
				phandle = <0x09>;

				pins_cmd_dat {
					pinmux = <0x4b01 0x4c01 0x4d01 0x4e01 0x4a01>;
					input-enable;
					drive-strength = <0x04>;
					bias-pull-up = <0x65>;
				};

				pins_clk {
					pinmux = <0x4901>;
					drive-strength = <0x04>;
					bias-pull-down = <0x66>;
				};
			};

			mmc1@0 {
				phandle = <0x0a>;

				pins_cmd_dat {
					pinmux = <0x4b01 0x4c01 0x4d01 0x4e01 0x4a01>;
					input-enable;
					drive-strength = <0x04>;
					bias-pull-up = <0x65>;
				};

				pins_clk {
					pinmux = <0x4901>;
					drive-strength = <0x04>;
					bias-pull-down = <0x66>;
				};
			};
		};
	};

	fragment@4 {
		target = <0xffffffff>;

		__overlay__ {
			reg = <0x00 0x1c023528 0x00 0x04>;
		};
	};

	fragment@5 {
		target = <0xffffffff>;

		__overlay__ {
			reg = <0x00 0x1c023520 0x00 0x04>;
		};
	};

	fragment@6 {
		target = <0xffffffff>;

		__overlay__ {
			reg = <0x00 0x1c02351c 0x00 0x04>;
		};
	};

	fragment@7 {
		target = <0xffffffff>;

		__overlay__ {
			reg = <0x00 0x1c023530 0x00 0x04>;
		};
	};

	fragment@8 {
		target = <0xffffffff>;

		__overlay__ {

			pmic@4 {

				mtk_dynamic_loading_throttling {
					compatible = "mediatek,mt6377-dynamic_loading_throttling";
					mediatek,charger = <0xffffffff>;
					uvlo-level = <0xa28>;
					io-channels = <0x01 0x0f 0x01 0x10 0x01 0x00>;
					io-channel-names = "pmic_ptim\0pmic_imix_r\0pmic_batadc";
					bootmode = <0xffffffff>;
					phandle = <0x1f>;
				};

				mtk_battery_oc_throttling {
					compatible = "mediatek,mt6377-battery_oc_throttling";
					oc-thd-h = <0x1a90>;
					oc-thd-l = <0x1f40>;
					phandle = <0xa8>;
				};
			};

			mt6319@3 {
				compatible = "mediatek,mt6319";
				reg = <0x03 0x00>;
				phandle = <0xa9>;

				extbuck-debug {
					compatible = "mediatek,spmi-pmic-debug";
				};

				mt6319-3-regulator {
					compatible = "mediatek,mt6315_3-regulator";
					buck-size = <0x03>;
					buck1-modeset-mask = <0x03>;
					phandle = <0xaa>;

					3-vbuck1 {
						regulator-compatible = "vbuck1";
						regulator-name = "3_vbuck1";
						regulator-min-microvolt = <0x493e0>;
						regulator-max-microvolt = <0x123716>;
						regulator-enable-ramp-delay = <0x100>;
						regulator-allowed-modes = <0x00 0x01 0x02>;
						regulator-always-on;
						phandle = <0x13>;
					};

					3-vbuck3 {
						regulator-compatible = "vbuck3";
						regulator-name = "3_vbuck3";
						regulator-min-microvolt = <0x493e0>;
						regulator-max-microvolt = <0x123716>;
						regulator-enable-ramp-delay = <0x100>;
						regulator-allowed-modes = <0x00 0x01 0x02>;
						phandle = <0x0d>;
					};

					3-vbuck4 {
						regulator-compatible = "vbuck4";
						regulator-name = "3_vbuck4";
						regulator-min-microvolt = <0x493e0>;
						regulator-max-microvolt = <0x123716>;
						regulator-enable-ramp-delay = <0x100>;
						regulator-allowed-modes = <0x00 0x01 0x02>;
						regulator-always-on;
						phandle = <0x14>;
					};
				};
			};
		};
	};

	fragment@9 {
		target = <0xffffffff>;

		__overlay__ {
			io-channels = <0x01 0x05 0x01 0x06 0x01 0x07 0x01 0x08>;
			io-channel-names = "pmic6377_ts1\0pmic6377_ts2\0pmic6377_ts3\0pmic6377_ts4";
			#thermal-sensor-cells = <0x01>;
			nvmem-cells = <0x0b>;
			nvmem-cell-names = "mt6377_e_data";
		};
	};

	fragment@10 {
		target = <0xffffffff>;

		__overlay__ {

			pmic6377_vs1 {
				polling-delay = <0x00>;
				polling-delay-passive = <0x00>;
				thermal-sensors = <0xffffffff 0x00>;
			};

			pmic6377_vbuck2 {
				polling-delay = <0x00>;
				polling-delay-passive = <0x00>;
				thermal-sensors = <0xffffffff 0x01>;
			};

			pmic6377_vemc {
				polling-delay = <0x00>;
				polling-delay-passive = <0x00>;
				thermal-sensors = <0xffffffff 0x02>;
			};

			pmic6377_vmch {
				polling-delay = <0x00>;
				polling-delay-passive = <0x00>;
				thermal-sensors = <0xffffffff 0x03>;
			};

			ap_ntc {
				polling-delay = <0x00>;
				polling-delay-passive = <0x00>;
				thermal-sensors = <0xffffffff>;
				phandle = <0xab>;
			};

			ltepa_ntc {
				polling-delay = <0x00>;
				polling-delay-passive = <0x00>;
				thermal-sensors = <0xffffffff>;
				phandle = <0xac>;
			};

			nrpa_ntc {
				polling-delay = <0x00>;
				polling-delay-passive = <0x00>;
				thermal-sensors = <0xffffffff>;
				phandle = <0xad>;
			};

			tsx_ntc {
				polling-delay = <0x00>;
				polling-delay-passive = <0x00>;
				thermal-sensors = <0xffffffff>;
				phandle = <0xae>;
			};
		};
	};

	fragment@11 {
		target = <0xffffffff>;

		__overlay__ {
			mt6377-support = <0x01>;
			_vcore-supply = <0x0c>;
			_vgpu-supply = <0x0d>;
			_vsram-supply = <0x0e>;
		};
	};

	fragment@12 {
		target = <0xffffffff>;

		__overlay__ {
			vcore-supply = <0x0c>;
		};
	};

	fragment@13 {
		target = <0xffffffff>;

		__overlay__ {
			sshub-vcore-supply = <0x0f>;
			sshub-vsram-supply = <0x10>;
		};
	};

	fragment@14 {
		target = <0xffffffff>;

		__overlay__ {
			vscp0-supply = <0x0f>;
		};
	};

	fragment@15 {
		target = <0xffffffff>;

		__overlay__ {
			vcc-supply = <0x11>;
		};
	};

	fragment@16 {
		target = <0xffffffff>;

		__overlay__ {
			_vcore-supply = <0x0c>;
		};
	};

	fragment@17 {
		target = <0xffffffff>;

		__overlay__ {
			interrupt-parent = <0x12>;
		};
	};

	fragment@18 {
		target = <0xffffffff>;

		__overlay__ {
			md-vmodem-supply = <0x13>;
			md-vmodem = <0xc96a8 0xc96a8>;
			md-vsram-supply = <0x14>;
			md-vsram = <0xc96a8 0xc96a8>;
			md-vdigrf-supply = <0x15>;
			md-vdigrf = <0xaae60 0xaae60>;
		};
	};

	fragment@19 {
		target = <0xffffffff>;

		__overlay__ {
			proc1-supply = <0x16>;
			proc2-supply = <0x17>;
			proc3-supply = <0x16>;
		};
	};

	fragment@20 {
		target = <0xffffffff>;

		__overlay__ {
			pwm-supply = "mt6377_vio28";
		};
	};

	fragment@21 {
		target = <0xffffffff>;

		__overlay__ {
			vib-supply = <0x18>;
		};
	};

	fragment@22 {
		target = <0xffffffff>;

		__overlay__ {

			goodix@0 {
				vtouch-supply = <0x19>;
			};
		};
	};

	fragment@23 {
		target = <0xffffffff>;

		__overlay__ {
			vusb33-supply = <0x1a>;
		};
	};

	fragment@24 {
		target = <0xffffffff>;

		__overlay__ {
			vmmc-supply = <0x11>;
			vqmmc-supply = <0x1b>;
		};
	};

	fragment@25 {
		target = <0xffffffff>;

		__overlay__ {
			vmmc-supply = <0x1c>;
			vqmmc-supply = <0x1d>;
		};
	};

	fragment@26 {
		target = <0xffffffff>;

		__overlay__ {
			suspend-ctl = "XO_SOC";
			md1-ctl = "XO_CEL";
			gps-ctl = "XO_WCN";
			mcu-ctl = "XO_WCN";
			nfc-ctl = "XO_NFC";
			ufs-ctl = "XO_SOC";
			mediatek,enable;
		};
	};

	fragment@27 {
		target = <0xffffffff>;

		__overlay__ {
		};
	};

	fragment@28 {
		target = <0xffffffff>;

		__overlay__ {
		};
	};

	fragment@29 {
		target = <0xffffffff>;

		__overlay__ {
			status = "disabled";
		};
	};

	fragment@30 {
		target = <0xffffffff>;

		__overlay__ {
			gauge = <0x1e>;
		};
	};

	fragment@31 {
		target = <0xffffffff>;

		__overlay__ {
			gauge = <0x1e>;
		};
	};

	fragment@32 {
		target = <0xffffffff>;

		__overlay__ {
			gauge = <0x1e>;
		};
	};

	fragment@33 {
		target = <0xffffffff>;

		__overlay__ {
			gauge = <0x1e>;
		};
	};

	fragment@34 {
		target = <0xffffffff>;

		__overlay__ {
			gauge = <0x1e>;
		};
	};

	fragment@35 {
		target = <0xffffffff>;

		__overlay__ {
			gauge = <0x1e>;
		};
	};

	fragment@36 {
		target = <0xffffffff>;

		__overlay__ {
			pmic-uvlo = <0x1f>;
		};
	};

	fragment@37 {
		target = <0xffffffff>;

		__overlay__ {
			gnss-pmic = <0x18e9>;
		};
	};

	fragment@38 {
		target = <0xffffffff>;

		__overlay__ {

			cam0@0 {
				phandle = <0x21>;

				pins_cmd_dat {
					pinmux = <0x1a00>;
					slew-rate = <0x01>;
					output-low;
				};
			};

			cam0@1 {
				phandle = <0x22>;

				pins_cmd_dat {
					pinmux = <0x1a00>;
					slew-rate = <0x01>;
					output-high;
				};
			};

			cam0@2 {
				phandle = <0x23>;

				pins_cmd_dat {
					pinmux = <0x1300>;
					slew-rate = <0x01>;
					output-low;
				};
			};

			cam0@3 {
				phandle = <0x24>;

				pins_cmd_dat {
					pinmux = <0x1300>;
					slew-rate = <0x01>;
					output-high;
				};
			};

			cam1@0 {
				phandle = <0x25>;

				pins_cmd_dat {
					pinmux = <0x1900>;
					slew-rate = <0x01>;
					output-low;
				};
			};

			cam1@1 {
				phandle = <0x26>;

				pins_cmd_dat {
					pinmux = <0x1900>;
					slew-rate = <0x01>;
					output-high;
				};
			};

			cam1@2 {
				phandle = <0x27>;

				pins_cmd_dat {
					pinmux = <0x1500>;
					slew-rate = <0x01>;
					output-low;
				};
			};

			cam1@3 {
				phandle = <0x28>;

				pins_cmd_dat {
					pinmux = <0x1500>;
					slew-rate = <0x01>;
					output-high;
				};
			};

			cam2@0 {
				phandle = <0x29>;

				pins_cmd_dat {
					pinmux = <0x1c00>;
					slew-rate = <0x01>;
					output-low;
				};
			};

			cam2@1 {
				phandle = <0x2a>;

				pins_cmd_dat {
					pinmux = <0x1c00>;
					slew-rate = <0x01>;
					output-high;
				};
			};

			cam2@2 {
				phandle = <0x2b>;

				pins_cmd_dat {
					pinmux = <0x1700>;
					slew-rate = <0x01>;
					output-low;
				};
			};

			cam2@3 {
				phandle = <0x2c>;

				pins_cmd_dat {
					pinmux = <0x1700>;
					slew-rate = <0x01>;
					output-high;
				};
			};

			cam3@0 {
				phandle = <0x2d>;

				pins_cmd_dat {
					pinmux = <0x1b00>;
					slew-rate = <0x01>;
					output-low;
				};
			};

			cam3@1 {
				phandle = <0x2e>;

				pins_cmd_dat {
					pinmux = <0x1b00>;
					slew-rate = <0x01>;
					output-high;
				};
			};

			cam3@2 {
				phandle = <0x2f>;

				pins_cmd_dat {
					pinmux = <0x1600>;
					slew-rate = <0x01>;
					output-low;
				};
			};

			cam3@3 {
				phandle = <0x30>;

				pins_cmd_dat {
					pinmux = <0x1600>;
					slew-rate = <0x01>;
					output-high;
				};
			};

			camera0_vcama_output_low@gpio56 {
				phandle = <0x32>;

				pins_cmd_dat {
					pinmux = <0x3800>;
					output-low;
				};
			};

			camera0_vcama_output_high@gpio56 {
				phandle = <0x31>;

				pins_cmd_dat {
					pinmux = <0x3800>;
					output-high;
				};
			};

			camera0_vcamd_output_low@gpio57 {
				phandle = <0x34>;

				pins_cmd_dat {
					pinmux = <0x3900>;
					output-low;
				};
			};

			camera0_vcamd_output_high@gpio57 {
				phandle = <0x33>;

				pins_cmd_dat {
					pinmux = <0x3900>;
					output-high;
				};
			};

			camera1_vcama_output_low@gpio59 {
				phandle = <0x36>;

				pins_cmd_dat {
					pinmux = <0x3b00>;
					output-low;
				};
			};

			camera1_vcama_output_high@gpio59 {
				phandle = <0x35>;

				pins_cmd_dat {
					pinmux = <0x3b00>;
					output-high;
				};
			};

			camera1_vcamd_output_low@gpio35 {
				phandle = <0x38>;

				pins_cmd_dat {
					pinmux = <0x2300>;
					output-low;
				};
			};

			camera1_vcamd_output_high@gpio35 {
				phandle = <0x37>;

				pins_cmd_dat {
					pinmux = <0x2300>;
					output-high;
				};
			};

			camera2_vcama_output_low@gpio59 {
				phandle = <0x3a>;

				pins_cmd_dat {
					pinmux = <0x3b00>;
					output-low;
				};
			};

			camera2_vcama_output_high@gpio59 {
				phandle = <0x39>;

				pins_cmd_dat {
					pinmux = <0x3b00>;
					output-high;
				};
			};

			camera2_vcamd_output_low@gpio13 {
				phandle = <0x3c>;

				pins_cmd_dat {
					pinmux = <0xd00>;
					output-low;
				};
			};

			camera2_vcamd_output_high@gpio13 {
				phandle = <0x3b>;

				pins_cmd_dat {
					pinmux = <0xd00>;
					output-high;
				};
			};

			camera3_vcama_output_low@gpio32 {
				phandle = <0x3e>;

				pins_cmd_dat {
					pinmux = <0x2000>;
					output-low;
				};
			};

			camera3_vcama_output_high@gpio32 {
				phandle = <0x3d>;

				pins_cmd_dat {
					pinmux = <0x2000>;
					output-high;
				};
			};

			camera3_vcamd_output_low@gpio13 {
				phandle = <0x40>;

				pins_cmd_dat {
					pinmux = <0xd00>;
					output-low;
				};
			};

			camera3_vcamd_output_high@gpio13 {
				phandle = <0x3f>;

				pins_cmd_dat {
					pinmux = <0xd00>;
					output-high;
				};
			};

			camera_pins_cam0_mclk_off {
				phandle = <0x41>;

				pins_cmd_dat {
					pinmux = <0x5900>;
					drive-strength = <0x01>;
				};
			};

			camera_pins_cam0_mclk_2ma {
				phandle = <0x42>;

				pins_cmd_dat {
					pinmux = <0x5901>;
					drive-strength = <0x00>;
				};
			};

			camera_pins_cam0_mclk_4ma {
				phandle = <0x43>;

				pins_cmd_dat {
					pinmux = <0x5901>;
					drive-strength = <0x01>;
				};
			};

			camera_pins_cam0_mclk_6ma {
				phandle = <0x44>;

				pins_cmd_dat {
					pinmux = <0x5901>;
					drive-strength = <0x02>;
				};
			};

			camera_pins_cam0_mclk_8ma {
				phandle = <0x45>;

				pins_cmd_dat {
					pinmux = <0x5901>;
					drive-strength = <0x03>;
				};
			};

			camera_pins_cam1_mclk_off {
				phandle = <0x46>;

				pins_cmd_dat {
					pinmux = <0x5800>;
					drive-strength = <0x01>;
				};
			};

			camera_pins_cam1_mclk_2ma {
				phandle = <0x47>;

				pins_cmd_dat {
					pinmux = <0x5801>;
					drive-strength = <0x00>;
				};
			};

			camera_pins_cam1_mclk_4ma {
				phandle = <0x48>;

				pins_cmd_dat {
					pinmux = <0x5801>;
					drive-strength = <0x01>;
				};
			};

			camera_pins_cam1_mclk_6ma {
				phandle = <0x49>;

				pins_cmd_dat {
					pinmux = <0x5801>;
					drive-strength = <0x02>;
				};
			};

			camera_pins_cam1_mclk_8ma {
				phandle = <0x4a>;

				pins_cmd_dat {
					pinmux = <0x5801>;
					drive-strength = <0x03>;
				};
			};

			camera_pins_cam2_mclk_off {
				phandle = <0x4b>;

				pins_cmd_dat {
					pinmux = <0x5b00>;
					drive-strength = <0x01>;
				};
			};

			camera_pins_cam2_mclk_2ma {
				phandle = <0x4c>;

				pins_cmd_dat {
					pinmux = <0x5b01>;
					drive-strength = <0x00>;
				};
			};

			camera_pins_cam2_mclk_4ma {
				phandle = <0x4d>;

				pins_cmd_dat {
					pinmux = <0x5b01>;
					drive-strength = <0x01>;
				};
			};

			camera_pins_cam2_mclk_6ma {
				phandle = <0x4e>;

				pins_cmd_dat {
					pinmux = <0x5b01>;
					drive-strength = <0x02>;
				};
			};

			camera_pins_cam2_mclk_8ma {
				phandle = <0x4f>;

				pins_cmd_dat {
					pinmux = <0x5b01>;
					drive-strength = <0x03>;
				};
			};

			camera_pins_cam3_mclk_off {
				phandle = <0x50>;

				pins_cmd_dat {
					pinmux = <0x5a00>;
					drive-strength = <0x01>;
				};
			};

			camera_pins_cam3_mclk_2ma {
				phandle = <0x51>;

				pins_cmd_dat {
					pinmux = <0x5a01>;
					drive-strength = <0x00>;
				};
			};

			camera_pins_cam3_mclk_4ma {
				phandle = <0x52>;

				pins_cmd_dat {
					pinmux = <0x5a01>;
					drive-strength = <0x01>;
				};
			};

			camera_pins_cam3_mclk_6ma {
				phandle = <0x53>;

				pins_cmd_dat {
					pinmux = <0x5a01>;
					drive-strength = <0x02>;
				};
			};

			camera_pins_cam3_mclk_8ma {
				phandle = <0x54>;

				pins_cmd_dat {
					pinmux = <0x5a01>;
					drive-strength = <0x03>;
				};
			};

			camera0_vcamio_output_low@gpio34 {
				phandle = <0x56>;

				pins_cmd_dat {
					pinmux = <0x2200>;
					output-low;
				};
			};

			camera0_vcamio_output_high@gpio34 {
				phandle = <0x55>;

				pins_cmd_dat {
					pinmux = <0x2200>;
					output-high;
				};
			};

			camera1_vcamio_output_low@gpio34 {
				phandle = <0x58>;

				pins_cmd_dat {
					pinmux = <0x2200>;
					output-low;
				};
			};

			camera1_vcamio_output_high@gpio34 {
				phandle = <0x57>;

				pins_cmd_dat {
					pinmux = <0x2200>;
					output-high;
				};
			};

			camera2_vcamio_output_low@gpio34 {
				phandle = <0x5a>;

				pins_cmd_dat {
					pinmux = <0x2200>;
					output-low;
				};
			};

			camera2_vcamio_output_high@gpio34 {
				phandle = <0x59>;

				pins_cmd_dat {
					pinmux = <0x2200>;
					output-high;
				};
			};

			camera3_vcamio_output_low@gpio34 {
				phandle = <0x5c>;

				pins_cmd_dat {
					pinmux = <0x2200>;
					output-low;
				};
			};

			camera3_vcamio_output_high@gpio34 {
				phandle = <0x5b>;

				pins_cmd_dat {
					pinmux = <0x2200>;
					output-high;
				};
			};

			mipi_en@1 {
				phandle = <0xaf>;

				pins_cmd_dat {
					pinmux = <0x6200>;
					slew-rate = <0x01>;
					output-high;
				};
			};

			mipi_en@0 {
				phandle = <0xb0>;

				pins_cmd_dat {
					pinmux = <0x6200>;
					slew-rate = <0x01>;
					output-low;
				};
			};

			mipi_sel@1 {
				phandle = <0xb1>;

				pins_cmd_dat {
					pinmux = <0x6100>;
					slew-rate = <0x01>;
					output-high;
				};
			};

			mipi_sel@0 {
				phandle = <0xb2>;

				pins_cmd_dat {
					pinmux = <0x6100>;
					slew-rate = <0x01>;
					output-low;
				};
			};

			camdefault {
				phandle = <0x20>;
			};
		};
	};

	fragment@39 {
		target = <0xffffffff>;

		__overlay__ {
			pinctrl-names = "default\0cam0_rst0\0cam0_rst1\0cam0_pnd0\0cam0_pnd1\0cam1_rst0\0cam1_rst1\0cam1_pnd0\0cam1_pnd1\0cam2_rst0\0cam2_rst1\0cam2_pnd0\0cam2_pnd1\0cam3_rst0\0cam3_rst1\0cam3_pnd0\0cam3_pnd1\0cam0_ldo_vcama_1\0cam0_ldo_vcama_0\0cam0_ldo_vcamd_1\0cam0_ldo_vcamd_0\0cam1_ldo_vcama_1\0cam1_ldo_vcama_0\0cam1_ldo_vcamd_1\0cam1_ldo_vcamd_0\0cam2_ldo_vcama_1\0cam2_ldo_vcama_0\0cam2_ldo_vcamd_1\0cam2_ldo_vcamd_0\0cam3_ldo_vcama_1\0cam3_ldo_vcama_0\0cam3_ldo_vcamd_1\0cam3_ldo_vcamd_0\0cam0_mclk_off\0cam0_mclk_2mA\0cam0_mclk_4mA\0cam0_mclk_6mA\0cam0_mclk_8mA\0cam1_mclk_off\0cam1_mclk_2mA\0cam1_mclk_4mA\0cam1_mclk_6mA\0cam1_mclk_8mA\0cam2_mclk_off\0cam2_mclk_2mA\0cam2_mclk_4mA\0cam2_mclk_6mA\0cam2_mclk_8mA\0cam3_mclk_off\0cam3_mclk_2mA\0cam3_mclk_4mA\0cam3_mclk_6mA\0cam3_mclk_8mA\0cam0_ldo_vcamio_1\0cam0_ldo_vcamio_0\0cam1_ldo_vcamio_1\0cam1_ldo_vcamio_0\0cam2_ldo_vcamio_1\0cam2_ldo_vcamio_0\0cam3_ldo_vcamio_1\0cam3_ldo_vcamio_0";
			pinctrl-0 = <0x20>;
			pinctrl-1 = <0x21>;
			pinctrl-2 = <0x22>;
			pinctrl-3 = <0x23>;
			pinctrl-4 = <0x24>;
			pinctrl-5 = <0x25>;
			pinctrl-6 = <0x26>;
			pinctrl-7 = <0x27>;
			pinctrl-8 = <0x28>;
			pinctrl-9 = <0x29>;
			pinctrl-10 = <0x2a>;
			pinctrl-11 = <0x2b>;
			pinctrl-12 = <0x2c>;
			pinctrl-13 = <0x2d>;
			pinctrl-14 = <0x2e>;
			pinctrl-15 = <0x2f>;
			pinctrl-16 = <0x30>;
			pinctrl-17 = <0x31>;
			pinctrl-18 = <0x32>;
			pinctrl-19 = <0x33>;
			pinctrl-20 = <0x34>;
			pinctrl-21 = <0x35>;
			pinctrl-22 = <0x36>;
			pinctrl-23 = <0x37>;
			pinctrl-24 = <0x38>;
			pinctrl-25 = <0x39>;
			pinctrl-26 = <0x3a>;
			pinctrl-27 = <0x3b>;
			pinctrl-28 = <0x3c>;
			pinctrl-29 = <0x3d>;
			pinctrl-30 = <0x3e>;
			pinctrl-31 = <0x3f>;
			pinctrl-32 = <0x40>;
			pinctrl-33 = <0x41>;
			pinctrl-34 = <0x42>;
			pinctrl-35 = <0x43>;
			pinctrl-36 = <0x44>;
			pinctrl-37 = <0x45>;
			pinctrl-38 = <0x46>;
			pinctrl-39 = <0x47>;
			pinctrl-40 = <0x48>;
			pinctrl-41 = <0x49>;
			pinctrl-42 = <0x4a>;
			pinctrl-43 = <0x4b>;
			pinctrl-44 = <0x4c>;
			pinctrl-45 = <0x4d>;
			pinctrl-46 = <0x4e>;
			pinctrl-47 = <0x4f>;
			pinctrl-48 = <0x50>;
			pinctrl-49 = <0x51>;
			pinctrl-50 = <0x52>;
			pinctrl-51 = <0x53>;
			pinctrl-52 = <0x54>;
			pinctrl-53 = <0x55>;
			pinctrl-54 = <0x56>;
			pinctrl-55 = <0x57>;
			pinctrl-56 = <0x58>;
			pinctrl-57 = <0x59>;
			pinctrl-58 = <0x5a>;
			pinctrl-59 = <0x5b>;
			pinctrl-60 = <0x5c>;
			cam0_vcamaf-supply = <0x19>;
			cam0_pin_mclk = "mclk";
			cam0_pin_rst = "gpio";
			cam0_pin_pnd = "gpio";
			cam0_pin_vcama = "gpio";
			cam0_pin_vcamio = "gpio";
			cam0_pin_vcamd = "gpio";
			cam0_pin_vcamaf = "regulator";
			cam1_pin_mclk = "mclk";
			cam1_pin_rst = "gpio";
			cam1_pin_pnd = "gpio";
			cam1_pin_vcama = "gpio";
			cam1_pin_vcamio = "gpio";
			cam1_pin_vcamd = "gpio";
			cam2_pin_mclk = "mclk";
			cam2_pin_rst = "gpio";
			cam2_pin_pnd = "gpio";
			cam2_pin_vcama = "gpio";
			cam2_pin_vcamio = "gpio";
			cam2_pin_vcamd = "gpio";
			cam3_pin_mclk = "mclk";
			cam3_pin_rst = "gpio";
			cam3_pin_pnd = "gpio";
			cam3_pin_vcama = "gpio";
			cam3_pin_vcamio = "gpio";
			cam3_pin_vcamd = "gpio";
			cam0_enable_sensor = "s5k3l8_mipi_raw ov50c40_mipi_raw";
			cam1_enable_sensor = "gc05a2sub_mipi_raw";
			cam2_enable_sensor = "bf2257csmacro_mipi_raw";
			cam3_enable_sensor = [00];
			status = "okay";
		};
	};

	fragment@40 {
		target = <0xffffffff>;

		__overlay__ {
			status = "okay";
			clock-frequency = <0x61a80>;
			#address-cells = <0x01>;
			#size-cells = <0x00>;

			camera_eeprom2@51 {
				compatible = "mediatek,camera_eeprom";
				reg = <0x51>;
				status = "okay";
				phandle = <0xb3>;
			};

			camera_main_two@1a {
				compatible = "mediatek,camera_main_two";
				#thermal-sensor-cells = <0x00>;
				reg = <0x1a>;
				status = "okay";
				phandle = <0x5f>;
			};
		};
	};

	fragment@41 {
		target = <0xffffffff>;

		__overlay__ {
			status = "okay";
			clock-frequency = <0x61a80>;
			#address-cells = <0x01>;
			#size-cells = <0x00>;

			camera_eeprom1@51 {
				compatible = "mediatek,camera_eeprom";
				reg = <0x51>;
				status = "okay";
				phandle = <0xb4>;
			};

			camera_sub@1a {
				compatible = "mediatek,camera_sub";
				#thermal-sensor-cells = <0x00>;
				reg = <0x1a>;
				status = "okay";
				phandle = <0x5e>;
			};

			camera_sub_two@10 {
				compatible = "mediatek,camera_sub_two";
				#thermal-sensor-cells = <0x00>;
				reg = <0x10>;
				status = "okay";
				phandle = <0xb5>;
			};
		};
	};

	fragment@42 {
		target = <0xffffffff>;

		__overlay__ {
			status = "okay";
			clock-frequency = <0x61a80>;
			#address-cells = <0x01>;
			#size-cells = <0x00>;

			camera_eeprom0@50 {
				compatible = "mediatek,camera_eeprom";
				reg = <0x50>;
				status = "okay";
				phandle = <0xb6>;
			};

			camera_main@1a {
				compatible = "mediatek,camera_main";
				#thermal-sensor-cells = <0x00>;
				reg = <0x1a>;
				status = "okay";
				phandle = <0x5d>;
			};
		};
	};

	fragment@43 {
		target = <0xffffffff>;

		__overlay__ {

			camera_main {
				polling-delay = <0x3e8>;
				polling-delay-passive = <0x00>;
				thermal-sensors = <0x5d>;
				phandle = <0xb7>;
			};

			camera_sub {
				polling-delay = <0x3e8>;
				polling-delay-passive = <0x00>;
				thermal-sensors = <0x5e>;
				phandle = <0xb8>;
			};

			camera_main_two {
				polling-delay = <0x3e8>;
				polling-delay-passive = <0x00>;
				thermal-sensors = <0x5f>;
				phandle = <0xb9>;
			};

			camera_sub_two {
				polling-delay = <0x3e8>;
				polling-delay-passive = <0x00>;
				thermal-sensors = <0x5f>;
				phandle = <0xba>;
			};
		};
	};

	fragment@44 {
		target = <0xffffffff>;

		__overlay__ {
			cust-sensor = "s5k3l8_mipi_raw ov50c40_mipi_raw gc05a2sub_mipi_raw bf2257csmacro_mipi_raw";
		};
	};

	fragment@45 {
		target = <0xffffffff>;

		__overlay__ {
			compatible = "mediatek,pwm-leds";

			backlight {
				led_mode = <0x05>;
				pwms = <0xffffffff 0x00 0x99d9>;
				pwm-names = "lcd-backlight";
				pwm_config = <0x00 0x01 0x00 0x00 0x00>;
			};
		};
	};

	fragment@46 {
		target = <0xffffffff>;

		__overlay__ {
			trustonic,real-drv = <0x01>;
		};
	};

	fragment@47 {
		target = <0xffffffff>;

		__overlay__ {

			lcm_led_en1_gpio {
				phandle = <0x60>;

				pins_cmd_dat {
					pinmux = <0x9600>;
					slew-rate = <0x01>;
					output-high;
				};
			};

			lcm_led_en0_gpio {
				phandle = <0x61>;

				pins_cmd_dat {
					pinmux = <0x9600>;
					slew-rate = <0x01>;
					output-low;
				};
			};

			lcm_rst_out1_gpio {
				phandle = <0x62>;

				pins_cmd_dat {
					pinmux = <0x5600>;
					slew-rate = <0x01>;
					output-high;
				};
			};

			lcm_rst_out0_gpio {
				phandle = <0x63>;

				pins_cmd_dat {
					pinmux = <0x5600>;
					slew-rate = <0x01>;
					output-low;
				};
			};

			lcm_dsi_te {
				phandle = <0x64>;

				pins_cmd_dat {
					pinmux = <0x5501>;
				};
			};

			lcm_cphy_out_gpio {
				phandle = <0x65>;

				pins_cmd_dat {
					pinmux = <0x8500>;
					slew-rate = <0x01>;
					output-high;
				};
			};
		};
	};

	fragment@48 {
		target = <0xffffffff>;

		__overlay__ {
			pinctrl-names = "lcm_led_en1_gpio\0lcm_led_en0_gpio\0lcm_rst_out1_gpio\0lcm_rst_out0_gpio\0mode_te_te\0lcm_cphy_out_gpio";
			pinctrl-0 = <0x60>;
			pinctrl-1 = <0x61>;
			pinctrl-2 = <0x62>;
			pinctrl-3 = <0x63>;
			pinctrl-4 = <0x64>;
			pinctrl-5 = <0x65>;
			status = "okay";
		};
	};

	fragment@49 {
		target = <0xffffffff>;

		__overlay__ {
			pinctrl-names = "lcm_rst_out1_gpio\0lcm_rst_out0_gpio\0mode_te_te\0lcm_cphy_out_gpio";
			pinctrl-0 = <0x62>;
			pinctrl-1 = <0x63>;
			pinctrl-2 = <0x64>;
			pinctrl-3 = <0x65>;
			status = "okay";
		};
	};

	fragment@50 {
		target = <0xffffffff>;

		__overlay__ {
			status = "okay";
			touch,reset-gpio = <0xffffffff 0x93 0x00>;
			touch,irq-gpio = <0xffffffff 0x04 0x00>;
			#address-cells = <0x01>;
			#size-cells = <0x00>;
			switch-fps = <0x5a>;
			switch-mode = "vfp";

			panel1@0 {
				compatible = "huike,ili9883,vdo";
				reg = <0x00>;
				pm-enable-gpios = <0xffffffff 0x2b 0x00>;
				reset-gpios = <0xffffffff 0x56 0x00>;
				bias-gpios = <0xffffffff 0x96 0x00 0xffffffff 0x97 0x00>;
				gate-ic = <0x12df>;
				lcd_vdd-supply = <0x66>;
				pinctrl-names = "default";

				port {

					endpoint {
						remote-endpoint = <0x67>;
						phandle = <0x6a>;
					};
				};
			};

			panel2@1 {
				compatible = "huayin,ft8057s,vdo";
				reg = <0x01>;
				pm-enable-gpios = <0xffffffff 0x2b 0x00>;
				reset-gpios = <0xffffffff 0x56 0x00>;
				bias-gpios = <0xffffffff 0x96 0x00 0xffffffff 0x97 0x00>;
				gate-ic = <0x12df>;
				lcd_vdd-supply = <0x66>;
				pinctrl-names = "default";

				port {

					endpoint {
						remote-endpoint = <0x68>;
						phandle = <0x6b>;
					};
				};
			};

			panel3@2 {
				compatible = "huashi,ili9883,vdo";
				reg = <0x02>;
				pm-enable-gpios = <0xffffffff 0x2b 0x00>;
				reset-gpios = <0xffffffff 0x56 0x00>;
				bias-gpios = <0xffffffff 0x96 0x00 0xffffffff 0x97 0x00>;
				gate-ic = <0x12df>;
				lcd_vdd-supply = <0x66>;
				pinctrl-names = "default";

				port {

					endpoint {
						remote-endpoint = <0x69>;
						phandle = <0x6c>;
					};
				};
			};

			ports {

				port {

					endpoint {
						remote-endpoint = <0x6a>;
						phandle = <0x67>;
					};

					endpoint2 {
						remote-endpoint = <0x6b>;
						phandle = <0x68>;
					};

					endpoint3 {
						remote-endpoint = <0x6c>;
						phandle = <0x69>;
					};
				};
			};
		};
	};

	fragment@51 {
		target = <0xffffffff>;

		__overlay__ {

			sel_high {
				phandle = <0x6d>;

				pins_cmd_dat {
					pinmux = <0x3600>;
					output-high;
				};
			};

			sel_low {
				phandle = <0x6e>;

				pins_cmd_dat {
					pinmux = <0x3600>;
					output-low;
				};
			};

			sw_enable {
				phandle = <0x6f>;

				pins_cmd_dat {
					pinmux = <0x1e00>;
					output-high;
				};
			};

			sw_disable {
				phandle = <0x70>;

				pins_cmd_dat {
					pinmux = <0x1e00>;
					output-high;
				};
			};
		};
	};

	fragment@52 {
		target = <0xffffffff>;

		__overlay__ {
			status = "disable";
		};
	};

	fragment@53 {
		target = <0xffffffff>;

		__overlay__ {
			pinctrl-names = "sel_up\0sel_down\0enable\0disable";
			pinctrl-0 = <0x6d>;
			pinctrl-1 = <0x6e>;
			pinctrl-2 = <0x6f>;
			pinctrl-3 = <0x70>;
			status = "disable";
		};
	};

	fragment@54 {
		target = <0xffffffff>;

		__overlay__ {

			port {

				endpoint@0 {
					remote-endpoint = <0x71>;
					phandle = <0x72>;
				};
			};
		};
	};

	fragment@55 {
		target = <0xffffffff>;

		__overlay__ {
			orientation-switch;
			mode-switch;
			accessory;

			port {

				endpoint@0 {
					remote-endpoint = <0x72>;
					phandle = <0x71>;
				};
			};
		};
	};

	fragment@56 {
		target = <0xffffffff>;

		__overlay__ {

			gps_default {
				phandle = <0x73>;
			};

			gps_l1_lna@0 {
				phandle = <0x74>;

				pins_cmd_dat {
					pinmux = <0x7b00>;
					output-low;
				};
			};

			gps_l1_lna@1 {
				phandle = <0x75>;

				pins_cmd_dat {
					pinmux = <0x7b04>;
				};
			};

			gps_l1_lna@2 {
				phandle = <0x76>;

				pins_cmd_dat {
					pinmux = <0x7b00>;
					output-high;
				};
			};

			gps_l5_lna@0 {
				phandle = <0x77>;

				pins_cmd_dat {
					pinmux = <0x7c00>;
					output-low;
				};
			};

			gps_l5_lna@1 {
				phandle = <0x78>;

				pins_cmd_dat {
					pinmux = <0x7c04>;
				};
			};

			gps_l5_lna@2 {
				phandle = <0x79>;

				pins_cmd_dat {
					pinmux = <0x7c00>;
					output-high;
				};
			};
		};
	};

	fragment@57 {
		target = <0xffffffff>;

		__overlay__ {
			pinctrl-names = "default\0gps_l1_lna_disable\0gps_l1_lna_dsp_ctrl\0gps_l1_lna_enable\0gps_l5_lna_disable\0gps_l5_lna_dsp_ctrl\0gps_l5_lna_enable";
			pinctrl-0 = <0x73>;
			pinctrl-1 = <0x74>;
			pinctrl-2 = <0x75>;
			pinctrl-3 = <0x76>;
			pinctrl-4 = <0x77>;
			pinctrl-5 = <0x78>;
			pinctrl-6 = <0x79>;
			status = "okay";
		};
	};

	fragment@58 {
		target = <0xffffffff>;

		__overlay__ {

			lm3643@63 {
				compatible = "mediatek,lm3643";
				reg = <0x63>;
				#cooling-cells = <0x02>;
				status = "okay";
				phandle = <0xbb>;

				flash@0 {
					reg = <0x00>;
					type = <0x00>;
					ct = <0x00>;
					part = <0x00>;

					port@0 {

						endpoint {
							remote-endpoint = <0x7a>;
							phandle = <0x81>;
						};
					};
				};

				flash@1 {
					reg = <0x01>;
					type = <0x00>;
					ct = <0x01>;
					part = <0x00>;

					port@1 {

						endpoint {
							remote-endpoint = <0x7b>;
							phandle = <0x82>;
						};
					};
				};
			};
		};
	};

	fragment@59 {
		target = <0xffffffff>;

		__overlay__ {
			pinctrl-names = "default\0hwen_high\0hwen_low\0flash_high\0flash_low";
			pinctrl-0 = <0x7c>;
			pinctrl-1 = <0x7d>;
			pinctrl-2 = <0x7e>;
			pinctrl-3 = <0x7f>;
			pinctrl-4 = <0x80>;
		};
	};

	fragment@60 {
		target = <0xffffffff>;

		__overlay__ {

			flashlight_aw_default {
				phandle = <0x7c>;
			};

			flashlight_aw_hwen_high@0 {
				phandle = <0x7d>;

				pins_cmd_dat {
					pinmux = <0x500>;
					slew-rate = <0x01>;
					output-high;
				};
			};

			flashlight_aw_hwen_low@1 {
				phandle = <0x7e>;

				pins_cmd_dat {
					pinmux = <0x500>;
					slew-rate = <0x01>;
					output-low;
				};
			};

			flashlight_aw_flash_high@2 {
				phandle = <0x7f>;

				pins_cmd_dat {
					pinmux = <0x600>;
					slew-rate = <0x01>;
					output-high;
				};
			};

			flashlight_aw_flash_low@3 {
				phandle = <0x80>;

				pins_cmd_dat {
					pinmux = <0x600>;
					slew-rate = <0x01>;
					output-low;
				};
			};
		};
	};

	fragment@61 {
		target = <0xffffffff>;

		__overlay__ {

			port@0 {

				endpoint {
					remote-endpoint = <0x81>;
					phandle = <0x7a>;
				};
			};

			port@1 {

				endpoint {
					remote-endpoint = <0x82>;
					phandle = <0x7b>;
				};
			};
		};
	};

	fragment@62 {
		target = <0xffffffff>;

		__overlay__ {

			camera_main_af@72 {
				compatible = "mediatek,camera_main_af";
				reg = <0x72>;
				status = "okay";
				phandle = <0xbc>;
			};
		};
	};

	fragment@63 {
		target = <0xffffffff>;

		__overlay__ {
			status = "okay";
		};
	};

	fragment@64 {
		target = <0xffffffff>;

		__overlay__ {

			focaltech@0 {
				status = "okay";
				compatible = "tchip,ilitek\0focaltech,fts";
				reg = <0x00>;
				spi-max-frequency = <0x989680>;
				interrupt-parent = <0xffffffff>;
				interrupts = <0x04 0x02 0x04 0x00>;
				touch,reset-gpio = <0xffffffff 0x93 0x00>;
				touch,irq-gpio = <0xffffffff 0x04 0x00>;
				focaltech,reset-gpio = <0xffffffff 0x93 0x00>;
				focaltech,irq-gpio = <0xffffffff 0x04 0x00>;
				focaltech,max-touch-number = <0x0a>;
				focaltech,display-coords = <0x00 0x00 0x2d0 0x64c>;
				pinctrl-names = "spi_cs_suspend\0spi_cs_resume";
				pinctrl-0 = <0x83>;
				pinctrl-1 = <0x84>;
			};
		};
	};

	fragment@65 {
		target = <0xffffffff>;

		__overlay__ {

			eintdefault {
				phandle = <0xbd>;
			};

			spi_cs_suspend {
				phandle = <0x83>;

				pins_cmd_dat {
					pinmux = <0x4500>;
					slew-rate = <0x01>;
					output-low;
				};
			};

			spi_cs_resume {
				phandle = <0x84>;

				pins_cmd_dat {
					pinmux = <0x4502>;
					input-enable;
				};
			};

			tp_spi_mode {
				phandle = <0xbe>;

				pins_cmd_dat {
					pinmux = <0x4402 0x4502 0x4602 0x4702>;
					drive-strength = <0x03>;
				};
			};
		};
	};

	fragment@66 {
		target = <0xffffffff>;

		__overlay__ {
			pd-vbus-upper-bound = <0x895440>;
		};
	};

	fragment@67 {
		target = <0xffffffff>;

		__overlay__ {
			enable-vbat-mon = <0x00>;
		};
	};

	fragment@68 {
		target = <0xffffffff>;

		__overlay__ {

			aw87xxx_pa@58 {
				compatible = "awinic,aw87xxx_pa";
				#sound-dai-cells = <0x00>;
				reg = <0x58>;
				dev_index = <0x00>;
				gpio_hac_en = <0xffffffff 0x5c 0x00>;
				status = "okay";
				phandle = <0x85>;
			};

			aw3750@3e {
				compatible = "awinic,aw3750";
				reg = <0x3e>;
				status = "okay";
				phandle = <0xbf>;
			};
		};
	};

	fragment@69 {
		target = <0xffffffff>;

		__overlay__ {
			mediatek,spk-i2s = <0x03 0x00>;

			mediatek,speaker-codec {
				sound-dai = <0x85>;
			};
		};
	};

	fragment@70 {
		target = <0xffffffff>;

		__overlay__ {

			focaltech_fpspi@0 {
				compatible = "focaltech,fpspi";
				reg = <0x00>;
				spi-max-frequency = <0x4c4b40>;
				status = "okay";
			};
		};
	};

	fragment@71 {
		target = <0xffffffff>;

		__overlay__ {
			status = "okay";
			interrupt-parent = <0xffffffff>;
			interrupts = <0x0f 0x01>;
			focaltech_fp,reset-gpio = <0xffffffff 0x07 0x00>;
			focaltech_fp,irq-gpio = <0xffffffff 0x0f 0x00>;
			focaltech_fp,vdd-gpio = <0xffffffff 0x03 0x00>;
			focaltech_fp,use-regulator;
			ff_vdd-supply = <0x86>;
			focaltech_fp,spiclk;
			focaltech_fp,read-chip;
			pinctrl-names = "ff_pins_reset_low\0ff_pins_reset_high\0ff_pins_irq_as_int";
			pinctrl-0 = <0x87>;
			pinctrl-1 = <0x88>;
			pinctrl-2 = <0x89>;
		};
	};

	fragment@72 {
		target = <0xffffffff>;

		__overlay__ {

			fprstout0 {
				phandle = <0x87>;

				pins_cmd_dat {
					pinmux = <0x700>;
					output-low;
				};
			};

			fprstout1 {
				phandle = <0x88>;

				pins_cmd_dat {
					pinmux = <0x700>;
					output-high;
				};
			};

			fpeint {
				phandle = <0x89>;

				pins_cmd_dat {
					pinmux = <0xf00>;
					bias-disable;
					input-enable;
				};
			};

			fpspi_mode {
				phandle = <0xc0>;

				pins_cmd_dat {
					pinmux = <0x3c02 0x3d02 0x3e02 0x3f02>;
				};
			};
		};
	};

	fragment@73 {
		target = <0xffffffff>;

		__overlay__ {

			MTEE {
				compatible = "mediatek,mtk_svp_on_mtee_support";
				phandle = <0xc1>;
			};

			SecureVideoPath {
				compatible = "mediatek,mtk_sec_video_path_support";
				phandle = <0xc2>;
			};
		};
	};

	fragment@74 {
		target = <0xffffffff>;

		__overlay__ {
			#address-cells = <0x01>;
			#size-cells = <0x00>;
			clock-frequency = <0x61a80>;
			status = "okay";

			sec-nfc@27 {
				compatible = "sec-nfc";
				reg = <0x27>;
				sec-nfc,ven-gpio = <0xffffffff 0x24 0x00>;
				sec-nfc,firm-gpio = <0xffffffff 0x25 0x00>;
				sec-nfc,irq-gpio = <0xffffffff 0x08 0x0f>;
			};
		};
	};

	fragment@75 {
		target = <0xffffffff>;

		__overlay__ {
			GPIO-SIM1-HOT-PLUG = <0xffffffff 0x30 0x00>;
			GPIO-SIM2-HOT-PLUG = <0xffffffff 0x31 0x00>;
			GPIO-SIM1-SCLK = <0xffffffff 0x4f 0x00>;
			GPIO-SIM1-SRST = <0xffffffff 0x50 0x00>;
			GPIO-SIM1-SIO = <0xffffffff 0x51 0x00>;
			GPIO-SIM2-SCLK = <0xffffffff 0x52 0x00>;
			GPIO-SIM2-SRST = <0xffffffff 0x53 0x00>;
			GPIO-SIM2-SIO = <0xffffffff 0x54 0x00>;
			GPIO-FDD-BAND-SUPPORT-DETECT-1ST-PIN = <0xffffffff 0xab 0x00>;
		};
	};

	fragment@76 {
		target = <0xffffffff>;

		__overlay__ {
			gpio-init-default = <0x00 0x00 0x00 0x00 0x01 0x01 0x01 0x01 0x00 0x00 0x00 0x01 0x00 0x01 0x02 0x02 0x00 0x00 0x01 0x00 0x01 0x03 0x00 0x00 0x00 0x01 0x01 0x01 0x04 0x00 0x00 0x00 0x00 0x00 0x01 0x05 0x00 0x01 0x00 0x01 0x00 0x01 0x06 0x00 0x01 0x00 0x01 0x00 0x01 0x07 0x00 0x01 0x00 0x01 0x00 0x01 0x08 0x00 0x00 0x00 0x01 0x00 0x01 0x09 0x00 0x00 0x00 0x01 0x01 0x01 0x0a 0x00 0x00 0x00 0x00 0x00 0x01 0x0b 0x07 0x00 0x00 0x01 0x00 0x01 0x0c 0x00 0x01 0x00 0x01 0x00 0x01 0x0d 0x00 0x00 0x00 0x01 0x01 0x01 0x0e 0x00 0x00 0x00 0x01 0x01 0x01 0x0f 0x00 0x00 0x00 0x01 0x00 0x01 0x10 0x00 0x00 0x00 0x01 0x00 0x01 0x11 0x00 0x00 0x00 0x01 0x01 0x01 0x12 0x00 0x01 0x00 0x01 0x00 0x01 0x13 0x00 0x01 0x00 0x01 0x00 0x01 0x14 0x00 0x00 0x00 0x01 0x00 0x01 0x15 0x00 0x01 0x00 0x01 0x00 0x01 0x16 0x00 0x01 0x00 0x01 0x00 0x01 0x17 0x00 0x01 0x00 0x01 0x00 0x01 0x18 0x00 0x00 0x00 0x01 0x00 0x01 0x19 0x00 0x01 0x00 0x01 0x00 0x01 0x1a 0x00 0x00 0x00 0x01 0x00 0x00 0x1b 0x00 0x01 0x00 0x01 0x00 0x01 0x1c 0x00 0x01 0x00 0x01 0x00 0x01 0x1d 0x00 0x00 0x00 0x01 0x00 0x01 0x1e 0x00 0x00 0x00 0x01 0x00 0x01 0x1f 0x01 0x00 0x00 0x01 0x01 0x01 0x20 0x07 0x00 0x00 0x01 0x01 0x01 0x21 0x07 0x00 0x00 0x01 0x00 0x01 0x22 0x03 0x00 0x00 0x01 0x00 0x01 0x23 0x03 0x00 0x00 0x01 0x01 0x01 0x24 0x00 0x01 0x00 0x01 0x00 0x00 0x25 0x00 0x01 0x00 0x01 0x00 0x00 0x26 0x00 0x00 0x00 0x01 0x00 0x00 0x27 0x01 0x00 0x00 0x01 0x00 0x01 0x28 0x01 0x00 0x00 0x01 0x00 0x01 0x29 0x01 0x00 0x00 0x01 0x00 0x01 0x2a 0x00 0x00 0x00 0x01 0x00 0x00 0x2b 0x00 0x00 0x00 0x01 0x00 0x01 0x2c 0x00 0x00 0x00 0x01 0x00 0x01 0x2d 0x00 0x00 0x00 0x01 0x00 0x01 0x2e 0x00 0x00 0x00 0x01 0x00 0x01 0x2f 0x00 0x00 0x00 0x01 0x00 0x01 0x30 0x01 0x00 0x00 0x01 0x01 0x01 0x31 0x01 0x00 0x00 0x01 0x01 0x01 0x32 0x01 0x00 0x00 0x00 0x00 0x01 0x33 0x01 0x00 0x00 0x01 0x01 0x01 0x34 0x00 0x00 0x00 0x01 0x00 0x01 0x35 0x00 0x00 0x00 0x01 0x00 0x01 0x36 0x00 0x00 0x00 0x01 0x00 0x01 0x37 0x07 0x00 0x00 0x01 0x00 0x01 0x38 0x07 0x00 0x00 0x01 0x00 0x01 0x39 0x07 0x00 0x00 0x01 0x00 0x01 0x3a 0x07 0x00 0x00 0x00 0x00 0x01 0x3b 0x07 0x00 0x00 0x01 0x00 0x01 0x3c 0x02 0x00 0x00 0x01 0x00 0x01 0x3d 0x02 0x00 0x00 0x01 0x01 0x01 0x3e 0x02 0x00 0x00 0x01 0x00 0x01 0x3f 0x02 0x00 0x00 0x01 0x00 0x01 0x40 0x01 0x00 0x00 0x01 0x00 0x01 0x41 0x01 0x00 0x00 0x01 0x01 0x01 0x42 0x01 0x00 0x00 0x01 0x00 0x01 0x43 0x01 0x00 0x00 0x01 0x00 0x01 0x44 0x02 0x00 0x00 0x00 0x00 0x01 0x45 0x02 0x00 0x00 0x00 0x00 0x01 0x46 0x02 0x00 0x00 0x00 0x00 0x01 0x47 0x02 0x00 0x00 0x00 0x00 0x01 0x49 0x01 0x00 0x00 0x00 0x00 0x01 0x4a 0x01 0x00 0x00 0x01 0x01 0x01 0x4b 0x01 0x00 0x00 0x01 0x01 0x01 0x4c 0x01 0x00 0x00 0x01 0x01 0x01 0x4d 0x01 0x00 0x00 0x01 0x01 0x01 0x4e 0x01 0x00 0x00 0x01 0x01 0x01 0x4f 0x01 0x00 0x00 0x00 0x00 0x01 0x50 0x01 0x00 0x00 0x00 0x00 0x01 0x51 0x01 0x00 0x00 0x01 0x01 0x01 0x52 0x01 0x00 0x00 0x00 0x00 0x01 0x53 0x01 0x00 0x00 0x00 0x00 0x01 0x54 0x01 0x00 0x00 0x01 0x01 0x01 0x55 0x01 0x00 0x00 0x01 0x00 0x01 0x56 0x00 0x01 0x00 0x01 0x00 0x01 0x57 0x01 0x00 0x00 0x00 0x00 0x01 0x58 0x01 0x00 0x00 0x01 0x00 0x01 0x59 0x00 0x00 0x00 0x01 0x00 0x00 0x5a 0x01 0x00 0x00 0x01 0x00 0x01 0x5b 0x01 0x00 0x00 0x01 0x00 0x01 0x5c 0x00 0x01 0x00 0x01 0x00 0x00 0x5d 0x01 0x00 0x00 0x01 0x00 0x01 0x5e 0x01 0x00 0x00 0x01 0x00 0x01 0x5f 0x01 0x00 0x00 0x00 0x00 0x01 0x60 0x01 0x00 0x00 0x00 0x00 0x01 0x61 0x01 0x00 0x00 0x00 0x00 0x01 0x62 0x01 0x00 0x00 0x00 0x00 0x01 0x63 0x01 0x00 0x00 0x00 0x00 0x01 0x64 0x01 0x00 0x00 0x00 0x00 0x01 0x65 0x00 0x00 0x00 0x01 0x00 0x01 0x66 0x01 0x00 0x00 0x00 0x00 0x01 0x67 0x00 0x00 0x00 0x01 0x00 0x01 0x68 0x00 0x00 0x00 0x01 0x00 0x01 0x69 0x01 0x00 0x00 0x00 0x00 0x01 0x6a 0x01 0x00 0x00 0x00 0x00 0x01 0x6b 0x01 0x00 0x00 0x00 0x00 0x01 0x6c 0x01 0x00 0x00 0x00 0x00 0x01 0x6d 0x01 0x00 0x00 0x00 0x00 0x01 0x6e 0x00 0x00 0x00 0x01 0x00 0x00 0x6f 0x00 0x00 0x00 0x01 0x00 0x00 0x70 0x00 0x00 0x00 0x00 0x00 0x01 0x71 0x00 0x00 0x00 0x00 0x00 0x01 0x72 0x00 0x00 0x00 0x00 0x00 0x01 0x73 0x01 0x00 0x00 0x00 0x00 0x01 0x74 0x01 0x00 0x00 0x01 0x00 0x01 0x75 0x01 0x00 0x00 0x00 0x00 0x01 0x76 0x01 0x00 0x00 0x01 0x00 0x01 0x77 0x00 0x00 0x00 0x01 0x00 0x01 0x78 0x00 0x00 0x00 0x01 0x00 0x01 0x79 0x00 0x00 0x00 0x01 0x00 0x01 0x7a 0x00 0x00 0x00 0x01 0x00 0x01 0x7b 0x04 0x00 0x00 0x01 0x00 0x01 0x7c 0x04 0x00 0x00 0x01 0x00 0x01 0x7d 0x01 0x00 0x00 0x01 0x00 0x01 0x7e 0x01 0x00 0x00 0x01 0x00 0x01 0x7f 0x00 0x00 0x00 0x01 0x00 0x01 0x80 0x00 0x00 0x00 0x01 0x00 0x01 0x81 0x02 0x00 0x00 0x01 0x01 0x01 0x82 0x02 0x00 0x00 0x01 0x01 0x01 0x83 0x01 0x00 0x00 0x01 0x01 0x01 0x84 0x01 0x00 0x00 0x01 0x01 0x01 0x85 0x01 0x00 0x00 0x01 0x01 0x01 0x86 0x01 0x00 0x00 0x01 0x01 0x01 0x87 0x01 0x00 0x00 0x01 0x01 0x01 0x88 0x01 0x00 0x00 0x01 0x01 0x01 0x89 0x01 0x00 0x00 0x01 0x01 0x01 0x8a 0x01 0x00 0x00 0x01 0x01 0x01 0x8b 0x01 0x00 0x00 0x01 0x01 0x01 0x8c 0x01 0x00 0x00 0x01 0x01 0x01 0x8d 0x01 0x00 0x00 0x01 0x01 0x01 0x8e 0x01 0x00 0x00 0x01 0x01 0x01 0x8f 0x01 0x00 0x00 0x01 0x01 0x01 0x90 0x01 0x00 0x00 0x01 0x01 0x01 0x91 0x00 0x00 0x00 0x01 0x00 0x01 0x92 0x00 0x00 0x00 0x01 0x00 0x01 0x93 0x00 0x01 0x00 0x01 0x00 0x01 0x94 0x00 0x01 0x00 0x01 0x00 0x01 0x95 0x04 0x00 0x00 0x01 0x00 0x01 0x96 0x00 0x01 0x00 0x01 0x00 0x01 0x97 0x00 0x00 0x00 0x01 0x00 0x01 0x98 0x01 0x00 0x00 0x00 0x00 0x01 0x99 0x01 0x00 0x00 0x00 0x00 0x01 0x9a 0x01 0x00 0x00 0x00 0x00 0x01 0x9b 0x01 0x00 0x00 0x00 0x00 0x01 0x9c 0x01 0x00 0x00 0x00 0x00 0x01 0x9d 0x01 0x00 0x00 0x00 0x00 0x01 0x9e 0x01 0x00 0x00 0x00 0x00 0x01 0x9f 0x01 0x00 0x00 0x01 0x00 0x01 0xa0 0x01 0x00 0x00 0x00 0x00 0x01 0xa1 0x01 0x00 0x00 0x00 0x00 0x01 0xa2 0x01 0x00 0x00 0x00 0x00 0x01 0xa3 0x01 0x00 0x00 0x00 0x00 0x01 0xa4 0x01 0x00 0x00 0x00 0x00 0x01 0xa5 0x00 0x00 0x00 0x01 0x00 0x01 0xa6 0x01 0x00 0x00 0x00 0x00 0x01 0xa7 0x01 0x00 0x00 0x00 0x00 0x01 0xa8 0x01 0x00 0x00 0x01 0x00 0x01 0xa9 0x01 0x00 0x00 0x01 0x00 0x01 0xaa 0x00 0x01 0x00 0x01 0x00 0x01 0xab 0x00 0x00 0x00 0x00 0x00 0x01 0xac 0x00 0x00 0x00 0x01 0x00 0x01 0xad 0x00 0x00 0x00 0x01 0x00 0x01 0xae 0x00 0x00 0x00 0x01 0x00 0x01 0xaf 0x00 0x00 0x00 0x01 0x00 0x01 0xb0 0x00 0x00 0x00 0x01 0x00 0x01 0xb1 0x00 0x00 0x00 0x01 0x00 0x01 0xb2 0x00 0x00 0x00 0x01 0x00 0x01 0xb3 0x00 0x00 0x00 0x01 0x00 0x01 0xb4 0x00 0x00 0x00 0x01 0x00 0x01 0xc1 0x00 0x00 0x00 0x01 0x00 0x00 0xc2 0x00 0x00 0x00 0x01 0x00 0x00 0xc3 0x00 0x00 0x00 0x01 0x00 0x00 0xc4 0x00 0x00 0x00 0x01 0x00 0x00 0xc5 0x00 0x00 0x00 0x01 0x00 0x00 0xc6 0x00 0x00 0x00 0x01 0x00 0x00 0xc7 0x00 0x00 0x00 0x01 0x00 0x00 0xc8 0x00 0x00 0x00 0x01 0x00 0x00 0xc9 0x00 0x00 0x00 0x01 0x00 0x00 0xca 0x00 0x00 0x00 0x01 0x00 0x00 0xcb 0x00 0x00 0x00 0x01 0x00 0x00 0xcc 0x00 0x00 0x00 0x01 0x00 0x00 0xcd 0x00 0x00 0x00 0x01 0x00 0x00 0xce 0x00 0x00 0x00 0x01 0x00 0x00 0xcf 0x00 0x00 0x00 0x01 0x00 0x00 0xd0 0x00 0x00 0x00 0x01 0x00 0x00 0xd1 0x00 0x00 0x00 0x01 0x00 0x00 0xd2 0x00 0x00 0x00 0x01 0x00 0x00 0xd3 0x00 0x00 0x00 0x01 0x00 0x00 0xd4 0x00 0x00 0x00 0x01 0x00 0x00>;
		};
	};

	fragment@77 {
		target = <0xffffffff>;

		__overlay__ {
			interrupt-parent = <0xffffffff>;
			interrupts = <0x00 0x08>;
			status = "okay";
		};
	};

	fragment@78 {
		target = <0xffffffff>;

		__overlay__ {
			interrupt-parent = <0xffffffff>;
			interrupts = <0x03 0x08>;
			status = "okay";
		};
	};

	fragment@79 {
		target = <0xffffffff>;

		__overlay__ {
			interrupt-parent = <0xffffffff>;
			interrupts = <0x0a 0x08>;
			deb-gpios = <0xffffffff 0x0a 0x00>;
			debounce = <0x3e800>;
			status = "okay";
		};
	};

	fragment@80 {
		target = <0xffffffff>;

		__overlay__ {
			interrupt-parent = <0xffffffff>;
			interrupts = <0x0d 0x08>;
			status = "okay";
		};
	};

	fragment@81 {
		target = <0xffffffff>;

		__overlay__ {
			interrupt-parent = <0xffffffff>;
			interrupts = <0x55 0x01>;
			status = "okay";
		};
	};

	fragment@82 {
		target = <0xffffffff>;

		__overlay__ {
			compatible = "mediatek,md1_sim1_hot_plug_eint-eint";
			interrupt-parent = <0xffffffff>;
			interrupts = <0x00 0x08>;
			debounce = <0x00 0xc350>;
			dedicated = <0x00 0x00>;
			src-pin = <0x00 0x01>;
			sockettype = <0x00 0x00>;
			status = "okay";
		};
	};

	fragment@83 {
		target = <0xffffffff>;

		__overlay__ {
			compatible = "mediatek,md1_sim2_hot_plug_eint-eint";
			interrupt-parent = <0xffffffff>;
			interrupts = <0x01 0x08>;
			debounce = <0x01 0xc350>;
			dedicated = <0x01 0x00>;
			src-pin = <0x01 0x02>;
			sockettype = <0x01 0x00>;
			status = "okay";
		};
	};

	fragment@84 {
		target = <0xffffffff>;

		__overlay__ {
			mediatek,key-debounce = <0x400>;
			mediatek,sw-pwrkey = <0x74>;
			mediatek,hw-pwrkey = <0x08>;
			mediatek,sw-rstkey = <0x73>;
			mediatek,hw-rstkey = <0x11>;
			mediatek,use-extend-type = <0x00>;
			mediatek,hw-map-num = <0x48>;
			mediatek,hw-init-map = <0x72 0x00 0x00 0x00 0x00 0x00 0x00 0x00 0x00 0x00 0x00 0x00 0x00 0x00 0x00 0x00 0x00 0x00 0x00 0x00 0x00 0x00 0x00 0x00 0x00 0x00 0x00 0x00 0x00 0x00 0x00 0x00 0x00 0x00 0x00 0x00 0x00 0x00 0x00 0x00 0x00 0x00 0x00 0x00 0x00 0x00 0x00 0x00 0x00 0x00 0x00 0x00 0x00 0x00 0x00 0x00 0x00 0x00 0x00 0x00 0x00 0x00 0x00 0x00 0x00 0x00 0x00 0x00 0x00 0x00 0x00 0x00>;
			mediatek,pwrkey-eint-gpio = <0x00>;
			mediatek,pwkey-gpio-din = <0x00>;
			mediatek,hw-dl-key0 = <0x11>;
			mediatek,hw-dl-key1 = <0x00>;
			mediatek,hw-dl-key2 = <0x08>;
			mediatek,hw-recovery-key = <0x11>;
			mediatek,hw-factory-key = <0x00>;
			status = "okay";
		};
	};

	__symbols__ {
		main_pmic = "/fragment@0/__overlay__/pmic@4";
		accdet = "/fragment@0/__overlay__/pmic@4/accdet";
		pmic_adc = "/fragment@0/__overlay__/pmic@4/mt6377-auxadc";
		mt6377_clock_buffer = "/fragment@0/__overlay__/pmic@4/mt6377_clock_buffer";
		mt6377codec = "/fragment@0/__overlay__/pmic@4/mt6377codec";
		mt6377_efuse = "/fragment@0/__overlay__/pmic@4/mt6377-efuse";
		mt6377_thermal_efuse = "/fragment@0/__overlay__/pmic@4/mt6377-efuse/mt6377_e_data";
		mt6377keys = "/fragment@0/__overlay__/pmic@4/mt6377keys";
		mtk_gauge = "/fragment@0/__overlay__/pmic@4/mtk_gauge";
		mt6377_vbuck1 = "/fragment@0/__overlay__/pmic@4/regulators/vbuck1";
		mt6377_vbuck2 = "/fragment@0/__overlay__/pmic@4/regulators/vbuck2";
		mt6377_vbuck3 = "/fragment@0/__overlay__/pmic@4/regulators/vbuck3";
		mt6377_vbuck4 = "/fragment@0/__overlay__/pmic@4/regulators/vbuck4";
		mt6377_vbuck5 = "/fragment@0/__overlay__/pmic@4/regulators/vbuck5";
		mt6377_vbuck6 = "/fragment@0/__overlay__/pmic@4/regulators/vbuck6";
		mt6377_vs1 = "/fragment@0/__overlay__/pmic@4/regulators/vs1";
		mt6377_vs2 = "/fragment@0/__overlay__/pmic@4/regulators/vs2";
		mt6377_vsram_md = "/fragment@0/__overlay__/pmic@4/regulators/vsram-md";
		mt6377_vsram_proc1 = "/fragment@0/__overlay__/pmic@4/regulators/vsram-proc1";
		mt6377_vsram_proc2 = "/fragment@0/__overlay__/pmic@4/regulators/vsram-proc2";
		mt6377_vsram_others = "/fragment@0/__overlay__/pmic@4/regulators/vsram-others";
		mt6377_va12 = "/fragment@0/__overlay__/pmic@4/regulators/va12";
		mt6377_vaud18 = "/fragment@0/__overlay__/pmic@4/regulators/vaud18";
		mt6377_vaud28 = "/fragment@0/__overlay__/pmic@4/regulators/vaud28";
		mt6377_vaux18 = "/fragment@0/__overlay__/pmic@4/regulators/vaux18";
		mt6377_vbif28 = "/fragment@0/__overlay__/pmic@4/regulators/vbif28";
		mt6377_vcn33_1 = "/fragment@0/__overlay__/pmic@4/regulators/vcn33-1";
		mt6377_vcn33_2 = "/fragment@0/__overlay__/pmic@4/regulators/vcn33-2";
		mt6377_vcn18 = "/fragment@0/__overlay__/pmic@4/regulators/vcn18";
		mt6377_vxo22 = "/fragment@0/__overlay__/pmic@4/regulators/vxo22";
		mt6377_vm18 = "/fragment@0/__overlay__/pmic@4/regulators/vm18";
		mt6377_vefuse = "/fragment@0/__overlay__/pmic@4/regulators/vefuse";
		mt6377_vemc = "/fragment@0/__overlay__/pmic@4/regulators/vemc";
		mt6377_vufs = "/fragment@0/__overlay__/pmic@4/regulators/vufs";
		mt6377_vio18 = "/fragment@0/__overlay__/pmic@4/regulators/vio18";
		mt6377_vrf18 = "/fragment@0/__overlay__/pmic@4/regulators/vrf18";
		mt6377_vrf12 = "/fragment@0/__overlay__/pmic@4/regulators/vrf12";
		mt6377_vrf09 = "/fragment@0/__overlay__/pmic@4/regulators/vrf09";
		mt6377_vrfva12 = "/fragment@0/__overlay__/pmic@4/regulators/vrfva12";
		mt6377_vrfio18 = "/fragment@0/__overlay__/pmic@4/regulators/vrfio18";
		mt6377_vmc = "/fragment@0/__overlay__/pmic@4/regulators/vmc";
		mt6377_vusb = "/fragment@0/__overlay__/pmic@4/regulators/vusb";
		mt6377_vibr = "/fragment@0/__overlay__/pmic@4/regulators/vibr";
		mt6377_vio28 = "/fragment@0/__overlay__/pmic@4/regulators/vio28";
		mt6377_vfp = "/fragment@0/__overlay__/pmic@4/regulators/vfp";
		mt6377_vtp = "/fragment@0/__overlay__/pmic@4/regulators/vtp";
		mt6377_isink_load = "/fragment@0/__overlay__/pmic@4/regulators/isink-load";
		mt6377_vbuck3_sshub = "/fragment@0/__overlay__/pmic@4/regulators/vbuck3-sshub";
		mt6377_vsram_others_sshub = "/fragment@0/__overlay__/pmic@4/regulators/vsram-others-sshub";
		mt6377_vmch_eint_low = "/fragment@0/__overlay__/pmic@4/regulators/vmch-eint-low";
		mt6377_lbat = "/fragment@0/__overlay__/pmic@4/lbat-service";
		mt6377_rtc = "/fragment@0/__overlay__/pmic@4/mt6377_rtc";
		fg_init = "/fragment@0/__overlay__/pmic@4/mt6377_rtc/fg_init";
		fg_soc = "/fragment@0/__overlay__/pmic@4/mt6377_rtc/fg_soc";
		ext_32k = "/fragment@0/__overlay__/pmic@4/mt6377_rtc/ext_32k";
		mmc0_pins_default = "/fragment@3/__overlay__/mmc0default";
		mmc0_pins_uhs = "/fragment@3/__overlay__/mmc0@0";
		mmc1_pins_default = "/fragment@3/__overlay__/mmc1default";
		mmc1_pins_uhs = "/fragment@3/__overlay__/mmc1@0";
		mt6377_dynamic_loading_throttling = "/fragment@8/__overlay__/pmic@4/mtk_dynamic_loading_throttling";
		mt6377_batoc_throttle = "/fragment@8/__overlay__/pmic@4/mtk_battery_oc_throttling";
		mt6319_3 = "/fragment@8/__overlay__/mt6319@3";
		mt6319_3_regulator = "/fragment@8/__overlay__/mt6319@3/mt6319-3-regulator";
		mt6319_3_vbuck1 = "/fragment@8/__overlay__/mt6319@3/mt6319-3-regulator/3-vbuck1";
		mt6319_3_vbuck3 = "/fragment@8/__overlay__/mt6319@3/mt6319-3-regulator/3-vbuck3";
		mt6319_3_vbuck4 = "/fragment@8/__overlay__/mt6319@3/mt6319-3-regulator/3-vbuck4";
		ap_ntc = "/fragment@10/__overlay__/ap_ntc";
		ltepa_ntc = "/fragment@10/__overlay__/ltepa_ntc";
		nrpa_ntc = "/fragment@10/__overlay__/nrpa_ntc";
		tsx_ntc = "/fragment@10/__overlay__/tsx_ntc";
		camera_pins_cam0_rst_0 = "/fragment@38/__overlay__/cam0@0";
		camera_pins_cam0_rst_1 = "/fragment@38/__overlay__/cam0@1";
		camera_pins_cam0_pnd_0 = "/fragment@38/__overlay__/cam0@2";
		camera_pins_cam0_pnd_1 = "/fragment@38/__overlay__/cam0@3";
		camera_pins_cam1_rst_0 = "/fragment@38/__overlay__/cam1@0";
		camera_pins_cam1_rst_1 = "/fragment@38/__overlay__/cam1@1";
		camera_pins_cam1_pnd_0 = "/fragment@38/__overlay__/cam1@2";
		camera_pins_cam1_pnd_1 = "/fragment@38/__overlay__/cam1@3";
		camera_pins_cam2_rst_0 = "/fragment@38/__overlay__/cam2@0";
		camera_pins_cam2_rst_1 = "/fragment@38/__overlay__/cam2@1";
		camera_pins_cam2_pnd_0 = "/fragment@38/__overlay__/cam2@2";
		camera_pins_cam2_pnd_1 = "/fragment@38/__overlay__/cam2@3";
		camera_pins_cam3_rst_0 = "/fragment@38/__overlay__/cam3@0";
		camera_pins_cam3_rst_1 = "/fragment@38/__overlay__/cam3@1";
		camera_pins_cam3_pnd_0 = "/fragment@38/__overlay__/cam3@2";
		camera_pins_cam3_pnd_1 = "/fragment@38/__overlay__/cam3@3";
		camera0_vcama_off = "/fragment@38/__overlay__/camera0_vcama_output_low@gpio56";
		camera0_vcama_on = "/fragment@38/__overlay__/camera0_vcama_output_high@gpio56";
		camera0_vcamd_off = "/fragment@38/__overlay__/camera0_vcamd_output_low@gpio57";
		camera0_vcamd_on = "/fragment@38/__overlay__/camera0_vcamd_output_high@gpio57";
		camera1_vcama_off = "/fragment@38/__overlay__/camera1_vcama_output_low@gpio59";
		camera1_vcama_on = "/fragment@38/__overlay__/camera1_vcama_output_high@gpio59";
		camera1_vcamd_off = "/fragment@38/__overlay__/camera1_vcamd_output_low@gpio35";
		camera1_vcamd_on = "/fragment@38/__overlay__/camera1_vcamd_output_high@gpio35";
		camera2_vcama_off = "/fragment@38/__overlay__/camera2_vcama_output_low@gpio59";
		camera2_vcama_on = "/fragment@38/__overlay__/camera2_vcama_output_high@gpio59";
		camera2_vcamd_off = "/fragment@38/__overlay__/camera2_vcamd_output_low@gpio13";
		camera2_vcamd_on = "/fragment@38/__overlay__/camera2_vcamd_output_high@gpio13";
		camera3_vcama_off = "/fragment@38/__overlay__/camera3_vcama_output_low@gpio32";
		camera3_vcama_on = "/fragment@38/__overlay__/camera3_vcama_output_high@gpio32";
		camera3_vcamd_off = "/fragment@38/__overlay__/camera3_vcamd_output_low@gpio13";
		camera3_vcamd_on = "/fragment@38/__overlay__/camera3_vcamd_output_high@gpio13";
		camera_pins_cam0_mclk_off = "/fragment@38/__overlay__/camera_pins_cam0_mclk_off";
		camera_pins_cam0_mclk_2ma = "/fragment@38/__overlay__/camera_pins_cam0_mclk_2ma";
		camera_pins_cam0_mclk_4ma = "/fragment@38/__overlay__/camera_pins_cam0_mclk_4ma";
		camera_pins_cam0_mclk_6ma = "/fragment@38/__overlay__/camera_pins_cam0_mclk_6ma";
		camera_pins_cam0_mclk_8ma = "/fragment@38/__overlay__/camera_pins_cam0_mclk_8ma";
		camera_pins_cam1_mclk_off = "/fragment@38/__overlay__/camera_pins_cam1_mclk_off";
		camera_pins_cam1_mclk_2ma = "/fragment@38/__overlay__/camera_pins_cam1_mclk_2ma";
		camera_pins_cam1_mclk_4ma = "/fragment@38/__overlay__/camera_pins_cam1_mclk_4ma";
		camera_pins_cam1_mclk_6ma = "/fragment@38/__overlay__/camera_pins_cam1_mclk_6ma";
		camera_pins_cam1_mclk_8ma = "/fragment@38/__overlay__/camera_pins_cam1_mclk_8ma";
		camera_pins_cam2_mclk_off = "/fragment@38/__overlay__/camera_pins_cam2_mclk_off";
		camera_pins_cam2_mclk_2ma = "/fragment@38/__overlay__/camera_pins_cam2_mclk_2ma";
		camera_pins_cam2_mclk_4ma = "/fragment@38/__overlay__/camera_pins_cam2_mclk_4ma";
		camera_pins_cam2_mclk_6ma = "/fragment@38/__overlay__/camera_pins_cam2_mclk_6ma";
		camera_pins_cam2_mclk_8ma = "/fragment@38/__overlay__/camera_pins_cam2_mclk_8ma";
		camera_pins_cam3_mclk_off = "/fragment@38/__overlay__/camera_pins_cam3_mclk_off";
		camera_pins_cam3_mclk_2ma = "/fragment@38/__overlay__/camera_pins_cam3_mclk_2ma";
		camera_pins_cam3_mclk_4ma = "/fragment@38/__overlay__/camera_pins_cam3_mclk_4ma";
		camera_pins_cam3_mclk_6ma = "/fragment@38/__overlay__/camera_pins_cam3_mclk_6ma";
		camera_pins_cam3_mclk_8ma = "/fragment@38/__overlay__/camera_pins_cam3_mclk_8ma";
		camera0_vcamio_off = "/fragment@38/__overlay__/camera0_vcamio_output_low@gpio34";
		camera0_vcamio_on = "/fragment@38/__overlay__/camera0_vcamio_output_high@gpio34";
		camera1_vcamio_off = "/fragment@38/__overlay__/camera1_vcamio_output_low@gpio34";
		camera1_vcamio_on = "/fragment@38/__overlay__/camera1_vcamio_output_high@gpio34";
		camera2_vcamio_off = "/fragment@38/__overlay__/camera2_vcamio_output_low@gpio34";
		camera2_vcamio_on = "/fragment@38/__overlay__/camera2_vcamio_output_high@gpio34";
		camera3_vcamio_off = "/fragment@38/__overlay__/camera3_vcamio_output_low@gpio34";
		camera3_vcamio_on = "/fragment@38/__overlay__/camera3_vcamio_output_high@gpio34";
		camera_pins_cam_mipi_switch_en_1 = "/fragment@38/__overlay__/mipi_en@1";
		camera_pins_cam_mipi_switch_en_0 = "/fragment@38/__overlay__/mipi_en@0";
		camera_pins_cam_mipi_switch_sel_1 = "/fragment@38/__overlay__/mipi_sel@1";
		camera_pins_cam_mipi_switch_sel_0 = "/fragment@38/__overlay__/mipi_sel@0";
		camera_pins_default = "/fragment@38/__overlay__/camdefault";
		mtk_camera_eeprom2 = "/fragment@40/__overlay__/camera_eeprom2@51";
		camera_main_two_mtk = "/fragment@40/__overlay__/camera_main_two@1a";
		mtk_camera_eeprom1 = "/fragment@41/__overlay__/camera_eeprom1@51";
		camera_sub_mtk = "/fragment@41/__overlay__/camera_sub@1a";
		camera_sub_two_mtk = "/fragment@41/__overlay__/camera_sub_two@10";
		mtk_camera_eeprom0 = "/fragment@42/__overlay__/camera_eeprom0@50";
		camera_main_mtk = "/fragment@42/__overlay__/camera_main@1a";
		camera_main = "/fragment@43/__overlay__/camera_main";
		camera_sub = "/fragment@43/__overlay__/camera_sub";
		camera_main_two = "/fragment@43/__overlay__/camera_main_two";
		camera_sub_two = "/fragment@43/__overlay__/camera_sub_two";
		mtkfb_pins_lcm_led_en1 = "/fragment@47/__overlay__/lcm_led_en1_gpio";
		mtkfb_pins_lcm_led_en0 = "/fragment@47/__overlay__/lcm_led_en0_gpio";
		mtkfb_pins_lcm_rst_out1_gpio = "/fragment@47/__overlay__/lcm_rst_out1_gpio";
		mtkfb_pins_lcm_rst_out0_gpio = "/fragment@47/__overlay__/lcm_rst_out0_gpio";
		mtkfb_pins_lcm_dsi_te = "/fragment@47/__overlay__/lcm_dsi_te";
		mtkfb_pins_lcm_cphy_out_gpio = "/fragment@47/__overlay__/lcm_cphy_out_gpio";
		panel_in1 = "/fragment@50/__overlay__/panel1@0/port/endpoint";
		panel_in2 = "/fragment@50/__overlay__/panel2@1/port/endpoint";
		panel_in3 = "/fragment@50/__overlay__/panel3@2/port/endpoint";
		dsi_out = "/fragment@50/__overlay__/ports/port/endpoint";
		dsi_out2 = "/fragment@50/__overlay__/ports/port/endpoint2";
		dsi_out3 = "/fragment@50/__overlay__/ports/port/endpoint3";
		sel_up = "/fragment@51/__overlay__/sel_high";
		sel_down = "/fragment@51/__overlay__/sel_low";
		sw_enable = "/fragment@51/__overlay__/sw_enable";
		sw_disable = "/fragment@51/__overlay__/sw_disable";
		tcpc_typec_usb = "/fragment@54/__overlay__/port/endpoint@0";
		ssusb_mux = "/fragment@55/__overlay__/port/endpoint@0";
		gps_pins_default = "/fragment@56/__overlay__/gps_default";
		gps_l1_lna_pins_ol = "/fragment@56/__overlay__/gps_l1_lna@0";
		gps_l1_lna_pins_dsp_ctrl = "/fragment@56/__overlay__/gps_l1_lna@1";
		gps_l1_lna_pins_oh = "/fragment@56/__overlay__/gps_l1_lna@2";
		gps_l5_lna_pins_ol = "/fragment@56/__overlay__/gps_l5_lna@0";
		gps_l5_lna_pins_dsp_ctrl = "/fragment@56/__overlay__/gps_l5_lna@1";
		gps_l5_lna_pins_oh = "/fragment@56/__overlay__/gps_l5_lna@2";
		lm3643 = "/fragment@58/__overlay__/lm3643@63";
		fl_core_0 = "/fragment@58/__overlay__/lm3643@63/flash@0/port@0/endpoint";
		fl_core_1 = "/fragment@58/__overlay__/lm3643@63/flash@1/port@1/endpoint";
		flashlight_aw_default = "/fragment@60/__overlay__/flashlight_aw_default";
		flashlight_aw_hwen_high = "/fragment@60/__overlay__/flashlight_aw_hwen_high@0";
		flashlight_aw_hwen_low = "/fragment@60/__overlay__/flashlight_aw_hwen_low@1";
		flashlight_aw_flash_high = "/fragment@60/__overlay__/flashlight_aw_flash_high@2";
		flashlight_aw_flash_low = "/fragment@60/__overlay__/flashlight_aw_flash_low@3";
		flashlight_0 = "/fragment@61/__overlay__/port@0/endpoint";
		flashlight_1 = "/fragment@61/__overlay__/port@1/endpoint";
		camera_main_af_mtk = "/fragment@62/__overlay__/camera_main_af@72";
		ctp_pins_default = "/fragment@65/__overlay__/eintdefault";
		spi_cs_int_suspend = "/fragment@65/__overlay__/spi_cs_suspend";
		spi_cs_int_resume = "/fragment@65/__overlay__/spi_cs_resume";
		ctp_spi_mode = "/fragment@65/__overlay__/tp_spi_mode";
		spk = "/fragment@68/__overlay__/aw87xxx_pa@58";
		aw3750 = "/fragment@68/__overlay__/aw3750@3e";
		fp_pins_rst_output0 = "/fragment@72/__overlay__/fprstout0";
		fp_pins_rst_output1 = "/fragment@72/__overlay__/fprstout1";
		fp_pins_eint = "/fragment@72/__overlay__/fpeint";
		fp_pins_spi_active = "/fragment@72/__overlay__/fpspi_mode";
		mtee = "/fragment@73/__overlay__/MTEE";
		svp = "/fragment@73/__overlay__/SecureVideoPath";
	};

	__fixups__ {
		spmi = "/fragment@0:target:0\0/fragment@8:target:0";
		clock_buffer_ctrl = "/fragment@0/__overlay__/pmic@4/mt6377_clock_buffer:clkbuf_ctl:0\0/fragment@27:target:0";
		chosen = "/fragment@0/__overlay__/pmic@4/mtk_gauge:bootmode:0\0/fragment@8/__overlay__/pmic@4/mtk_dynamic_loading_throttling:bootmode:0";
		mt6375_chg = "/fragment@0/__overlay__/pmic@4/mtk_gauge:charger:0\0/fragment@36:target:0";
		mmc0 = "/fragment@1:target:0\0/fragment@24:target:0";
		dvfsrc_vcore = "/fragment@1/__overlay__:dvfsrc-vcore-supply:0\0/fragment@2/__overlay__:dvfsrc-vcore-supply:0";
		mmc1 = "/fragment@2:target:0\0/fragment@25:target:0";
		pio = "/fragment@2/__overlay__:cd-gpios:0\0/fragment@3:target:0\0/fragment@38:target:0\0/fragment@47:target:0\0/fragment@50/__overlay__:touch,reset-gpio:0\0/fragment@50/__overlay__:touch,irq-gpio:0\0/fragment@50/__overlay__/panel1@0:pm-enable-gpios:0\0/fragment@50/__overlay__/panel1@0:reset-gpios:0\0/fragment@50/__overlay__/panel1@0:bias-gpios:0\0/fragment@50/__overlay__/panel1@0:bias-gpios:12\0/fragment@50/__overlay__/panel2@1:pm-enable-gpios:0\0/fragment@50/__overlay__/panel2@1:reset-gpios:0\0/fragment@50/__overlay__/panel2@1:bias-gpios:0\0/fragment@50/__overlay__/panel2@1:bias-gpios:12\0/fragment@50/__overlay__/panel3@2:pm-enable-gpios:0\0/fragment@50/__overlay__/panel3@2:reset-gpios:0\0/fragment@50/__overlay__/panel3@2:bias-gpios:0\0/fragment@50/__overlay__/panel3@2:bias-gpios:12\0/fragment@51:target:0\0/fragment@56:target:0\0/fragment@60:target:0\0/fragment@64/__overlay__/focaltech@0:interrupt-parent:0\0/fragment@64/__overlay__/focaltech@0:touch,reset-gpio:0\0/fragment@64/__overlay__/focaltech@0:touch,irq-gpio:0\0/fragment@64/__overlay__/focaltech@0:focaltech,reset-gpio:0\0/fragment@64/__overlay__/focaltech@0:focaltech,irq-gpio:0\0/fragment@65:target:0\0/fragment@68/__overlay__/aw87xxx_pa@58:gpio_hac_en:0\0/fragment@71/__overlay__:interrupt-parent:0\0/fragment@71/__overlay__:focaltech_fp,reset-gpio:0\0/fragment@71/__overlay__:focaltech_fp,irq-gpio:0\0/fragment@71/__overlay__:focaltech_fp,vdd-gpio:0\0/fragment@72:target:0\0/fragment@74/__overlay__/sec-nfc@27:sec-nfc,ven-gpio:0\0/fragment@74/__overlay__/sec-nfc@27:sec-nfc,firm-gpio:0\0/fragment@74/__overlay__/sec-nfc@27:sec-nfc,irq-gpio:0\0/fragment@75/__overlay__:GPIO-SIM1-HOT-PLUG:0\0/fragment@75/__overlay__:GPIO-SIM2-HOT-PLUG:0\0/fragment@75/__overlay__:GPIO-SIM1-SCLK:0\0/fragment@75/__overlay__:GPIO-SIM1-SRST:0\0/fragment@75/__overlay__:GPIO-SIM1-SIO:0\0/fragment@75/__overlay__:GPIO-SIM2-SCLK:0\0/fragment@75/__overlay__:GPIO-SIM2-SRST:0\0/fragment@75/__overlay__:GPIO-SIM2-SIO:0\0/fragment@75/__overlay__:GPIO-FDD-BAND-SUPPORT-DETECT-1ST-PIN:0\0/fragment@77/__overlay__:interrupt-parent:0\0/fragment@78/__overlay__:interrupt-parent:0\0/fragment@79/__overlay__:interrupt-parent:0\0/fragment@79/__overlay__:deb-gpios:0\0/fragment@80/__overlay__:interrupt-parent:0\0/fragment@81/__overlay__:interrupt-parent:0\0/fragment@82/__overlay__:interrupt-parent:0\0/fragment@83/__overlay__:interrupt-parent:0";
		dvfsrc = "/fragment@2/__overlay__:interconnects:0\0/fragment@2/__overlay__:interconnects:8";
		dvfsrc_freq_opp4 = "/fragment@2/__overlay__:required-opps:0";
		tboard_thermistor1 = "/fragment@4:target:0\0/fragment@10/__overlay__/ap_ntc:thermal-sensors:0";
		tboard_thermistor2 = "/fragment@5:target:0\0/fragment@10/__overlay__/ltepa_ntc:thermal-sensors:0";
		tboard_thermistor3 = "/fragment@6:target:0\0/fragment@10/__overlay__/nrpa_ntc:thermal-sensors:0";
		tsx_thermistor = "/fragment@7:target:0\0/fragment@10/__overlay__/tsx_ntc:thermal-sensors:0";
		lk_charger = "/fragment@8/__overlay__/pmic@4/mtk_dynamic_loading_throttling:mediatek,charger:0";
		mt6377_temp = "/fragment@9:target:0\0/fragment@10/__overlay__/pmic6377_vs1:thermal-sensors:0\0/fragment@10/__overlay__/pmic6377_vbuck2:thermal-sensors:0\0/fragment@10/__overlay__/pmic6377_vemc:thermal-sensors:0\0/fragment@10/__overlay__/pmic6377_vmch:thermal-sensors:0";
		thermal_zones = "/fragment@10:target:0\0/fragment@43:target:0";
		gpufreq = "/fragment@11:target:0";
		dvfsrc_helper = "/fragment@12:target:0";
		scp_dvfs = "/fragment@13:target:0";
		scp = "/fragment@14:target:0";
		ufshci = "/fragment@15:target:0";
		mmdvfs = "/fragment@16:target:0";
		pmic_oc_debug = "/fragment@17:target:0";
		mddriver = "/fragment@18:target:0";
		cpuhvfs = "/fragment@19:target:0";
		irtx_pwm = "/fragment@20:target:0";
		regulator_vibrator = "/fragment@21:target:0";
		spi3 = "/fragment@22:target:0\0/fragment@64:target:0";
		ssusb = "/fragment@23:target:0";
		srclken_rc = "/fragment@26:target:0";
		mt6685_clock_buffer = "/fragment@28:target:0";
		mt6685_rtc = "/fragment@29:target:0";
		pe = "/fragment@30:target:0";
		pe2 = "/fragment@31:target:0";
		pe45 = "/fragment@32:target:0";
		pe5 = "/fragment@33:target:0";
		pdc = "/fragment@34:target:0\0/fragment@66:target:0";
		charger = "/fragment@35:target:0\0/fragment@67:target:0";
		gps = "/fragment@37:target:0\0/fragment@57:target:0";
		kd_camera_hw1 = "/fragment@39:target:0\0/fragment@44:target:0";
		i2c8 = "/fragment@40:target:0";
		i2c2 = "/fragment@41:target:0";
		i2c4 = "/fragment@42:target:0\0/fragment@62:target:0";
		mtk_leds = "/fragment@45:target:0";
		disp_pwm = "/fragment@45/__overlay__/backlight:pwms:0";
		mobicore = "/fragment@46:target:0";
		mtkfb = "/fragment@48:target:0";
		dispsys_config = "/fragment@49:target:0";
		dsi0 = "/fragment@50:target:0";
		ps5169 = "/fragment@52:target:0";
		fusb304 = "/fragment@53:target:0";
		usb_type_c_aw35616 = "/fragment@54:target:0";
		typec_mux_switch = "/fragment@55:target:0";
		i2c6 = "/fragment@58:target:0\0/fragment@68:target:0";
		flashlights_aw3641e_gpio = "/fragment@59:target:0";
		mtk_composite_v4l2_1 = "/fragment@61:target:0";
		camera_af_hw_node = "/fragment@63:target:0";
		sound = "/fragment@69:target:0";
		spi1 = "/fragment@70:target:0";
		focaltech_fp = "/fragment@71:target:0";
		mtee_svp = "/fragment@73:target:0";
		i2c3 = "/fragment@74:target:0";
		gpio_usage_mapping = "/fragment@75:target:0";
		gpio = "/fragment@76:target:0";
		mrdump_ext_rst = "/fragment@77:target:0";
		subpmic_pmu_eint = "/fragment@78:target:0";
		swtp = "/fragment@79:target:0";
		smart_pa = "/fragment@80:target:0";
		dsi_te = "/fragment@81:target:0";
		md1_sim1_hot_plug_eint = "/fragment@82:target:0";
		md1_sim2_hot_plug_eint = "/fragment@83:target:0";
		keypad = "/fragment@84:target:0";
	};

	__local_fixups__ {

		fragment@0 {

			__overlay__ {

				pmic@4 {

					accdet {
						io-channels = <0x00>;
						nvmem = <0x00>;
					};

					mt6377-auxadc {
						isink_load-supply = <0x00>;
					};

					mt6377codec {
						io-channels = <0x00>;
						nvmem = <0x00>;
						reg-vaud28-supply = <0x00>;
					};

					mtk_gauge {
						io-channels = <0x00 0x08 0x10 0x18 0x20 0x28>;
						nvmem-cells = <0x00 0x04>;
					};
				};
			};
		};

		fragment@1 {

			__overlay__ {
				pinctrl-0 = <0x00>;
				pinctrl-1 = <0x00>;
			};
		};

		fragment@2 {

			__overlay__ {
				pinctrl-0 = <0x00>;
				pinctrl-1 = <0x00>;
			};
		};

		fragment@8 {

			__overlay__ {

				pmic@4 {

					mtk_dynamic_loading_throttling {
						io-channels = <0x00 0x08 0x10>;
					};
				};
			};
		};

		fragment@9 {

			__overlay__ {
				io-channels = <0x00 0x08 0x10 0x18>;
				nvmem-cells = <0x00>;
			};
		};

		fragment@11 {

			__overlay__ {
				_vcore-supply = <0x00>;
				_vgpu-supply = <0x00>;
				_vsram-supply = <0x00>;
			};
		};

		fragment@12 {

			__overlay__ {
				vcore-supply = <0x00>;
			};
		};

		fragment@13 {

			__overlay__ {
				sshub-vcore-supply = <0x00>;
				sshub-vsram-supply = <0x00>;
			};
		};

		fragment@14 {

			__overlay__ {
				vscp0-supply = <0x00>;
			};
		};

		fragment@15 {

			__overlay__ {
				vcc-supply = <0x00>;
			};
		};

		fragment@16 {

			__overlay__ {
				_vcore-supply = <0x00>;
			};
		};

		fragment@17 {

			__overlay__ {
				interrupt-parent = <0x00>;
			};
		};

		fragment@18 {

			__overlay__ {
				md-vmodem-supply = <0x00>;
				md-vsram-supply = <0x00>;
				md-vdigrf-supply = <0x00>;
			};
		};

		fragment@19 {

			__overlay__ {
				proc1-supply = <0x00>;
				proc2-supply = <0x00>;
				proc3-supply = <0x00>;
			};
		};

		fragment@21 {

			__overlay__ {
				vib-supply = <0x00>;
			};
		};

		fragment@22 {

			__overlay__ {

				goodix@0 {
					vtouch-supply = <0x00>;
				};
			};
		};

		fragment@23 {

			__overlay__ {
				vusb33-supply = <0x00>;
			};
		};

		fragment@24 {

			__overlay__ {
				vmmc-supply = <0x00>;
				vqmmc-supply = <0x00>;
			};
		};

		fragment@25 {

			__overlay__ {
				vmmc-supply = <0x00>;
				vqmmc-supply = <0x00>;
			};
		};

		fragment@30 {

			__overlay__ {
				gauge = <0x00>;
			};
		};

		fragment@31 {

			__overlay__ {
				gauge = <0x00>;
			};
		};

		fragment@32 {

			__overlay__ {
				gauge = <0x00>;
			};
		};

		fragment@33 {

			__overlay__ {
				gauge = <0x00>;
			};
		};

		fragment@34 {

			__overlay__ {
				gauge = <0x00>;
			};
		};

		fragment@35 {

			__overlay__ {
				gauge = <0x00>;
			};
		};

		fragment@36 {

			__overlay__ {
				pmic-uvlo = <0x00>;
			};
		};

		fragment@39 {

			__overlay__ {
				pinctrl-0 = <0x00>;
				pinctrl-1 = <0x00>;
				pinctrl-2 = <0x00>;
				pinctrl-3 = <0x00>;
				pinctrl-4 = <0x00>;
				pinctrl-5 = <0x00>;
				pinctrl-6 = <0x00>;
				pinctrl-7 = <0x00>;
				pinctrl-8 = <0x00>;
				pinctrl-9 = <0x00>;
				pinctrl-10 = <0x00>;
				pinctrl-11 = <0x00>;
				pinctrl-12 = <0x00>;
				pinctrl-13 = <0x00>;
				pinctrl-14 = <0x00>;
				pinctrl-15 = <0x00>;
				pinctrl-16 = <0x00>;
				pinctrl-17 = <0x00>;
				pinctrl-18 = <0x00>;
				pinctrl-19 = <0x00>;
				pinctrl-20 = <0x00>;
				pinctrl-21 = <0x00>;
				pinctrl-22 = <0x00>;
				pinctrl-23 = <0x00>;
				pinctrl-24 = <0x00>;
				pinctrl-25 = <0x00>;
				pinctrl-26 = <0x00>;
				pinctrl-27 = <0x00>;
				pinctrl-28 = <0x00>;
				pinctrl-29 = <0x00>;
				pinctrl-30 = <0x00>;
				pinctrl-31 = <0x00>;
				pinctrl-32 = <0x00>;
				pinctrl-33 = <0x00>;
				pinctrl-34 = <0x00>;
				pinctrl-35 = <0x00>;
				pinctrl-36 = <0x00>;
				pinctrl-37 = <0x00>;
				pinctrl-38 = <0x00>;
				pinctrl-39 = <0x00>;
				pinctrl-40 = <0x00>;
				pinctrl-41 = <0x00>;
				pinctrl-42 = <0x00>;
				pinctrl-43 = <0x00>;
				pinctrl-44 = <0x00>;
				pinctrl-45 = <0x00>;
				pinctrl-46 = <0x00>;
				pinctrl-47 = <0x00>;
				pinctrl-48 = <0x00>;
				pinctrl-49 = <0x00>;
				pinctrl-50 = <0x00>;
				pinctrl-51 = <0x00>;
				pinctrl-52 = <0x00>;
				pinctrl-53 = <0x00>;
				pinctrl-54 = <0x00>;
				pinctrl-55 = <0x00>;
				pinctrl-56 = <0x00>;
				pinctrl-57 = <0x00>;
				pinctrl-58 = <0x00>;
				pinctrl-59 = <0x00>;
				pinctrl-60 = <0x00>;
				cam0_vcamaf-supply = <0x00>;
			};
		};

		fragment@43 {

			__overlay__ {

				camera_main {
					thermal-sensors = <0x00>;
				};

				camera_sub {
					thermal-sensors = <0x00>;
				};

				camera_main_two {
					thermal-sensors = <0x00>;
				};

				camera_sub_two {
					thermal-sensors = <0x00>;
				};
			};
		};

		fragment@48 {

			__overlay__ {
				pinctrl-0 = <0x00>;
				pinctrl-1 = <0x00>;
				pinctrl-2 = <0x00>;
				pinctrl-3 = <0x00>;
				pinctrl-4 = <0x00>;
				pinctrl-5 = <0x00>;
			};
		};

		fragment@49 {

			__overlay__ {
				pinctrl-0 = <0x00>;
				pinctrl-1 = <0x00>;
				pinctrl-2 = <0x00>;
				pinctrl-3 = <0x00>;
			};
		};

		fragment@50 {

			__overlay__ {

				panel1@0 {
					lcd_vdd-supply = <0x00>;

					port {

						endpoint {
							remote-endpoint = <0x00>;
						};
					};
				};

				panel2@1 {
					lcd_vdd-supply = <0x00>;

					port {

						endpoint {
							remote-endpoint = <0x00>;
						};
					};
				};

				panel3@2 {
					lcd_vdd-supply = <0x00>;

					port {

						endpoint {
							remote-endpoint = <0x00>;
						};
					};
				};

				ports {

					port {

						endpoint {
							remote-endpoint = <0x00>;
						};

						endpoint2 {
							remote-endpoint = <0x00>;
						};

						endpoint3 {
							remote-endpoint = <0x00>;
						};
					};
				};
			};
		};

		fragment@53 {

			__overlay__ {
				pinctrl-0 = <0x00>;
				pinctrl-1 = <0x00>;
				pinctrl-2 = <0x00>;
				pinctrl-3 = <0x00>;
			};
		};

		fragment@54 {

			__overlay__ {

				port {

					endpoint@0 {
						remote-endpoint = <0x00>;
					};
				};
			};
		};

		fragment@55 {

			__overlay__ {

				port {

					endpoint@0 {
						remote-endpoint = <0x00>;
					};
				};
			};
		};

		fragment@57 {

			__overlay__ {
				pinctrl-0 = <0x00>;
				pinctrl-1 = <0x00>;
				pinctrl-2 = <0x00>;
				pinctrl-3 = <0x00>;
				pinctrl-4 = <0x00>;
				pinctrl-5 = <0x00>;
				pinctrl-6 = <0x00>;
			};
		};

		fragment@58 {

			__overlay__ {

				lm3643@63 {

					flash@0 {

						port@0 {

							endpoint {
								remote-endpoint = <0x00>;
							};
						};
					};

					flash@1 {

						port@1 {

							endpoint {
								remote-endpoint = <0x00>;
							};
						};
					};
				};
			};
		};

		fragment@59 {

			__overlay__ {
				pinctrl-0 = <0x00>;
				pinctrl-1 = <0x00>;
				pinctrl-2 = <0x00>;
				pinctrl-3 = <0x00>;
				pinctrl-4 = <0x00>;
			};
		};

		fragment@61 {

			__overlay__ {

				port@0 {

					endpoint {
						remote-endpoint = <0x00>;
					};
				};

				port@1 {

					endpoint {
						remote-endpoint = <0x00>;
					};
				};
			};
		};

		fragment@64 {

			__overlay__ {

				focaltech@0 {
					pinctrl-0 = <0x00>;
					pinctrl-1 = <0x00>;
				};
			};
		};

		fragment@69 {

			__overlay__ {

				mediatek,speaker-codec {
					sound-dai = <0x00>;
				};
			};
		};

		fragment@71 {

			__overlay__ {
				ff_vdd-supply = <0x00>;
				pinctrl-0 = <0x00>;
				pinctrl-1 = <0x00>;
				pinctrl-2 = <0x00>;
			};
		};
	};
};
